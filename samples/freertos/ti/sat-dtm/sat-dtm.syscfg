/**
 * @cliArgs --board "/ti/boards/LP_EM_CC2755P10" --rtos "freertos" --product "simplelink_lowpower_f3_sdk@9.20.00.81" --product "Hubble Network SDK@1.0.0"
 * @versions {"tool":"1.26.3+4529"}
 */

/**
 * Import the modules used in this configuration.
 */
const Hubble   = scripting.addModule("/Hubble");
const FreeRTOS = scripting.addModule("/freertos/FreeRTOS");
const custom   = scripting.addModule("/ti/devices/radioconfig/custom");
const GPIO     = scripting.addModule("/ti/drivers/GPIO");
const GPIO1    = GPIO.addInstance();
const Power    = scripting.addModule("/ti/drivers/Power");
const UART2    = scripting.addModule("/ti/drivers/UART2", {}, false);
const UART21   = UART2.addInstance();
const Settings = scripting.addModule("/ti/posix/freertos/Settings");

/**
 * Write custom configuration values to the imported modules.
 */
Hubble.useTerrestrial       = false;
Hubble.enforceNonceCheck    = false;
Hubble.useSatellite         = true;
Hubble.dtmMode              = true;
Hubble.counterSource        = "device-uptime";

var hubble_radio = system.getScript("/hubble_radio.js");
hubble_radio.config();

custom.ble                                              = ["ble_gen"];
custom.radioConfigble_gen.$name                         = "RF_BLE_Setting";
custom.radioConfigble_gen.codeExportConfig.$name        = "ti_devices_radioconfig_code_export_param0";
custom.radioConfigble_gen.codeExportConfig.cmdList_ble  = ["cmdGenericTxTest"];
custom.radioConfigble_gen.codeExportConfig.symGenMethod = "Automatic";

GPIO1.$hardware = system.deviceData.board.components.LED_RED;
GPIO1.$name     = "CONFIG_GPIO_LED_0";

const CCFG              = scripting.addModule("/ti/devices/CCFG", {}, false);
CCFG.ccfgTemplate.$name = "ti_devices_CCFG_CCFGCC27XXTemplate0";

UART21.$name     = "CONFIG_UART2_0";
UART21.$hardware = system.deviceData.board.components.XDS110UART;

/**
 * References between modules.
 */
CCFG.defaultLfoscCompProfile = null;

/**
 * Pinmux solution for unlocked pins/peripherals. This ensures that minor changes to the automatic solver in a future
 * version of the tool will not impact the pinmux you originally saw.  These lines can be completely deleted in order to
 * re-solve from scratch.
 */
GPIO1.gpioPin.$suggestSolution            = "boosterpack.36";
UART21.uart.$suggestSolution              = "UART0";
UART21.uart.dmaTxChannel.$suggestSolution = "DMA_CH2";
UART21.uart.dmaRxChannel.$suggestSolution = "DMA_CH3";
UART21.uart.txPin.$suggestSolution        = "boosterpack.4";
UART21.uart.rxPin.$suggestSolution        = "boosterpack.3";
