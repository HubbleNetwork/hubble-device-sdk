/**
 * @cliArgs --board "/ti/boards/LP_EM_CC2340R5" --device "CC2340R5RKP" --part "Default" --package "RKP" --rtos "freertos" --product "simplelink_lowpower_f3_sdk@9.20.00.07_ea"
 * @versions {"tool":"1.23.2+4156"}
 */

/**
 * Import the modules used in this configuration.
 */
const FreeRTOS              = scripting.addModule("/freertos/FreeRTOS");
const ble                   = scripting.addModule("/ti/ble/ble");
const CCFG                  = scripting.addModule("/ti/devices/CCFG");
const AESCCM                = scripting.addModule("/ti/drivers/AESCCM");
const AESCCM1               = AESCCM.addInstance();
const AESCMAC               = scripting.addModule("/ti/drivers/AESCMAC", {}, false);
const AESCMAC1              = AESCMAC.addInstance();
const AESCTR                = scripting.addModule("/ti/drivers/AESCTR", {}, false);
const AESCTR1               = AESCTR.addInstance();
const AESECB                = scripting.addModule("/ti/drivers/AESECB");
const AESECB1               = AESECB.addInstance();
const ECDH                  = scripting.addModule("/ti/drivers/ECDH");
const ECDH1                 = ECDH.addInstance();
const GPIO                  = scripting.addModule("/ti/drivers/GPIO");
const GPIO1                 = GPIO.addInstance();
const GPIO2                 = GPIO.addInstance();
const NVS                   = scripting.addModule("/ti/drivers/NVS");
const NVS1                  = NVS.addInstance();
const Power                 = scripting.addModule("/ti/drivers/Power");
const RNG                   = scripting.addModule("/ti/drivers/RNG");
const RNG1                  = RNG.addInstance();
const Button                = scripting.addModule("/ti/drivers/apps/Button", {}, false);
const Button1               = Button.addInstance();
const Button2               = Button.addInstance();
const LogModule             = scripting.addModule("/ti/log/LogModule", {}, false);
const LogModule1            = LogModule.addInstance();
const LogSinkUART           = scripting.addModule("/ti/log/LogSinkUART", {}, false);
const LogSinkUART1          = LogSinkUART.addInstance();
const Settings              = scripting.addModule("/ti/posix/freertos/Settings");
const Hubble                = scripting.addModule("/Hubble");

/**
 * Write custom configuration values to the imported modules.
 */
FreeRTOS.heapSize       = 0x00004900;
FreeRTOS.timerStackSize = 0x00000190;
FreeRTOS.idleStackSize  = 0x00000130;

ble.deviceName                            = "Hubble-TI";
ble.radioConfig.codeExportConfig.$name    = "ti_devices_radioconfig_code_export_param0";
ble.adcNoiseConfig.codeExportConfig.$name = "ti_devices_radioconfig_code_export_param1";
ble.bleCsConfig.codeExportConfig.$name    = "ti_devices_radioconfig_code_export_param2";
ble.connUpdateParamsPeripheral.$name      = "ti_ble_general_ble_conn_update_params0";
ble.advSet1.$name                         = "ti_ble_broadcaster_advertisement_set0";
ble.advSet1.advParam1.$name               = "ti_ble_broadcaster_advertisement_params0";
ble.advSet1.advData1.$name                = "ti_ble_broadcaster_advertisement_data0";
ble.advSet1.scanRes1.$name                = "ti_ble_broadcaster_advertisement_data1";
ble.advSet2.$name                         = "ti_ble_broadcaster_advertisement_set1";
ble.advSet2.advParam2.$name               = "ti_ble_broadcaster_advertisement_params1";
ble.advSet2.advData2.$name                = "ti_ble_broadcaster_advertisement_data2";
ble.advSet2.scanRes2.$name                = "ti_ble_broadcaster_advertisement_data3";
ble.rng.$name                             = "CONFIG_RNG_1";
ble.aesccm.$name                          = "CONFIG_AESCCM_0";
ble.ecdh.$name                            = "CONFIG_ECDH_0";
ble.aesctrdrbg.$name                      = "CONFIG_AESCTRDRBG_1";
ble.aesecb.$name                          = "CONFIG_AESECB_0";

Hubble.useTerrestrial = true;
Hubble.useSatellite   = true;

var hubble_radio = system.getScript("/hubble_radio.js");
hubble_radio.config_dual_stack("blePeripheral");

CCFG.ccfgTemplate.$name = "ti_devices_CCFG_CCFGCC23X0Template0";

AESCCM1.$name = "CONFIG_AESCCM0";

AESCMAC1.$name = "CONFIG_AESCMAC_0";

AESCTR1.$name = "CONFIG_AESCTR_0";

AESECB1.$name = "CONFIG_AESECB0";

ECDH1.$name = "CONFIG_ECDH0";

GPIO1.$hardware = system.deviceData.board.components.LED_GREEN;
GPIO1.$name     = "CONFIG_GPIO_LED_GREEN";

GPIO2.$hardware = system.deviceData.board.components.LED_RED;
GPIO2.$name     = "CONFIG_GPIO_LED_RED";

NVS1.$name                    = "CONFIG_NVSINTERNAL";
NVS1.internalFlash.$name      = "ti_drivers_nvs_NVSLPF30";
NVS1.internalFlash.regionBase = 0x7D000;
NVS1.internalFlash.regionSize = 0x3000;

RNG.rngReturnBehavior = "RNG_RETURN_BEHAVIOR_BLOCKING";

RNG1.$name = "CONFIG_RNG_0";

Button1.$name     = "CONFIG_BUTTON_0";
Button1.$hardware = system.deviceData.board.components["BTN-1"];

Button2.$name     = "CONFIG_BUTTON_1";
Button2.$hardware = system.deviceData.board.components["BTN-2"];

const AESCommonXXF3 = scripting.addModule("/ti/drivers/cryptoutils/aes/AESCommonXXF3", {}, false);

LogModule1.loggerSink = "/ti/log/LogSinkUART";
LogModule1.$name      = "Log_Dual_Stack";

LogSinkUART1.$name                   = "CONFIG_ti_log_LogSinkUART_0";
LogSinkUART1.BufferSize              = 512;
LogModule1.logger                    = LogSinkUART1;
LogSinkUART1.uart.$name              = "CONFIG_UART2_0";
LogSinkUART1.uart.$hardware          = system.deviceData.board.components.XDS110UART;
LogSinkUART1.uart.uart.txPin.$assign = "boosterpack.4";

/**
 * Pinmux solution for unlocked pins/peripherals. This ensures that minor changes to the automatic solver in a future
 * version of the tool will not impact the pinmux you originally saw.  These lines can be completely deleted in order to
 * re-solve from scratch.
 */
GPIO1.gpioPin.$suggestSolution                       = "boosterpack.40";
GPIO2.gpioPin.$suggestSolution                       = "boosterpack.39";
Button1.button.$suggestSolution                      = "boosterpack.13";
Button2.button.$suggestSolution                      = "boosterpack.12";
AESCommonXXF3.laes.$suggestSolution                  = "LAES";
AESCommonXXF3.laes.dataLaesChannelA.$suggestSolution = "DMA_CH4";
AESCommonXXF3.laes.dataLaesChannelB.$suggestSolution = "DMA_CH5";
