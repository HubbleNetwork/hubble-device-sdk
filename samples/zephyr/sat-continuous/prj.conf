## CMakeLists.txt
```
# Copyright (c) 2026 Hubble Network, Inc.
# SPDX-License-Identifier: Apache-2.0

cmake_minimum_required(VERSION 3.13.1)
find_package(Zephyr REQUIRED HINTS $ENV{ZEPHYR_BASE})

project(app LANGUAGES C)

# The Hubble master key is provisioned at build time via the
# CONFIG_SAMPLE_HUBBLE_KEY Kconfig option (a base64 string), e.g.
#
#   west build -b <board> . -- -DCONFIG_SAMPLE_HUBBLE_KEY="<base64 key>"
#
# It is decoded into bytes at runtime (Zephyr provides base64_decode). If it is
# omitted (e.g. a CI build-only run) the firmware falls back to an all-zero
# placeholder. See src/main.c and Kconfig.

target_sources(app PRIVATE src/main.c)
```

## Kconfig
```
# Copyright (c) 2026 Hubble Network, Inc.
# SPDX-License-Identifier: Apache-2.0

menu "Hubble Network Satellite Sample options"

config SAMPLE_PROVIDE_SAT_BOARD_SUPPORT
    bool "Provide satellite board suport for test purpose"
    default y
    help
	Targets that support satellite must select it, otherwise
	board APIs will be mocked in the sample.

config SAMPLE_SAT_TX_INTERVAL_SECONDS
    int "Inter-transmission sleep in seconds"
    default 10
    help
	Time the sample sleeps between consecutive satellite packet
	transmissions, in seconds.

config SAMPLE_HUBBLE_KEY
    string "Base64-encoded Hubble master key"
    default ""
    help
	Base64-encoded master key provisioned at build time. Pass it with
	west build ... -- -DCONFIG_SAMPLE_HUBBLE_KEY=\"<base64 key>\".
	If left empty, an all-zero placeholder is used: the sample still
	builds but will not produce valid advertisements until a real key
	is supplied.

endmenu

source "Kconfig.zephyr"

module = APP
module-str = APP
source "subsys/logging/Kconfig.template.log_config"
```

## sample.yaml
```
# Copyright (c) 2026 Hubble Network, Inc.
# SPDX-License-Identifier: Apache-2.0

sample:
  description: Hubble Satellite example
  name: hubble-sat-continuous
common:
  build_only: true
  # Some test platforms fail because don't enable random subsys.
  # Let's filter them out.
  platform_allow:
    - native_sim
  tags:
    - satellite
tests:
  app.sat.continuous.default:
    extra_configs:
      - CONFIG_SAMPLE_PROVIDE_SAT_BOARD_SUPPORT=y
  app.sat.continuous.128key:
    extra_configs:
      - CONFIG_HUBBLE_NETWORK_KEY_128=y
      - CONFIG_SAMPLE_PROVIDE_SAT_BOARD_SUPPORT=y
  app.sat.continuous.mbedtls:
    extra_configs:
      - CONFIG_HUBBLE_NETWORK_CRYPTO_MBEDTLS=y
      - CONFIG_SAMPLE_PROVIDE_SAT_BOARD_SUPPORT=y
  app.sat.continuous.mbedtls_128key:
    extra_configs:
      - CONFIG_HUBBLE_NETWORK_CRYPTO_MBEDTLS=y
      - CONFIG_HUBBLE_NETWORK_KEY_128=y
      - CONFIG_SAMPLE_PROVIDE_SAT_BOARD_SUPPORT=y
  app.sat.continuous.ncs:
    extra_configs:
      - CONFIG_SAMPLE_PROVIDE_SAT_BOARD_SUPPORT=n
    modules:
      - nrf
    platform_exclude:
      - native_sim
    platform_allow:
      - nrf21540dk/nrf52840
      - thingy53/nrf5340/cpunet
      - nrf54l15dk/nrf54l15/cpuapp
    integration_platforms:
      - nrf21540dk/nrf52840
      - thingy53/nrf5340/cpunet
      - nrf54l15dk/nrf54l15/cpuapp
```

## prj.conf
```kconfig
# Copyright (c) 2026 Hubble Network, Inc.
# SPDX-License-Identifier: Apache-2.0

# Hubble Network
CONFIG_HUBBLE_SAT_NETWORK=y

# Decode the base64 master key (passed via -DHUBBLE_KEY) on the device.
CONFIG_BASE64=y

# Logging, so the key-provisioning warning/error and other status are visible.
CONFIG_LOG=y

# Use the device uptime counter source so the device does not need UTC time
# provisioned. The EID counter starts from the value passed to hubble_init()
# and advances with uptime.
CONFIG_HUBBLE_COUNTER_SOURCE_DEVICE_UPTIME=y

# Disable nonce-reuse enforcement for this sample. The check persists the
# sequence counter to NVS and rejects reused/decreasing counters; this sample
# transmits continuously and needs no NVS, so turn it off.
CONFIG_HUBBLE_NETWORK_SECURITY_ENFORCE_NONCE_CHECK=n

CONFIG_MAIN_STACK_SIZE=4096
```

## boards/xiao_mg24.conf
```kconfig
CONFIG_SAMPLE_PROVIDE_SAT_BOARD_SUPPORT=n
```

## src/main.c
```c
/*
 * Copyright (c) 2026 Hubble Network, Inc.
 * SPDX-License-Identifier: Apache-2.0
 */

#include <hubble/hubble.h>
#include <hubble/sat/packet.h>

#include <zephyr/kernel.h>
#include <zephyr/logging/log.h>
#include <zephyr/sys/base64.h>

#include <errno.h>
#include <stdint.h>
#include <stdlib.h>
#include <string.h>

LOG_MODULE_REGISTER(main);

/*
 * Decoded master key. The SDK stores this pointer directly, so the buffer has
 * static storage duration and outlives all SDK calls. Zero-initialised, which
 * also serves as the all-zero placeholder when no key is provided.
 */
static uint8_t master_key[CONFIG_HUBBLE_KEY_SIZE];

/*
 * Decode the base64 master key (CONFIG_SAMPLE_HUBBLE_KEY, provisioned at build
 * time) into master_key, validating its length.
 */
static int master_key_provision(void)
{
	const char *key = CONFIG_SAMPLE_HUBBLE_KEY;
	size_t olen;
	int err;

	if (strlen(key) == 0) {
		LOG_WRN("CONFIG_SAMPLE_HUBBLE_KEY not set; using an all-zero "
			"placeholder key. Pass your base64 key with "
			"-DCONFIG_SAMPLE_HUBBLE_KEY=\"<key>\".");
		return 0;
	}

	err = base64_decode(master_key, sizeof(master_key), &olen, key,
			    strlen(key));
	if (err != 0 || olen != sizeof(master_key)) {
		LOG_ERR("Invalid CONFIG_SAMPLE_HUBBLE_KEY: expected a base64-"
			"encoded %u-byte key (matching CONFIG_HUBBLE_KEY_SIZE)",
			(unsigned int)sizeof(master_key));
		return -EINVAL;
	}

	return 0;
}

#ifdef CONFIG_SAMPLE_PROVIDE_SAT_BOARD_SUPPORT

int hubble_sat_board_init(void)
{
	return 0;
}

int hubble_sat_board_enable(void)
{
	return 0;
}

int hubble_sat_board_disable(void)
{
	return 0;
}

int hubble_sat_board_packet_send(const struct hubble_sat_packet_frames *packet)
{
	ARG_UNUSED(packet);

	return 0;
}

#endif /* CONFIG_SAMPLE_PROVIDE_SAT_BOARD_SUPPORT */


int main(void)
{
	int err = 0;
	struct hubble_sat_packet pkt;

	LOG_DBG("Hubble Network Sat Sample started");

	err = master_key_provision();
	if (err != 0) {
		goto end;
	}

	/*
	 * This sample uses the device uptime counter source
	 * (CONFIG_HUBBLE_COUNTER_SOURCE_DEVICE_UPTIME), so no UTC time is needed:
	 * we pass 0 as the initial EID counter value and it advances with uptime.
	 */
	err = hubble_init(0, 0, master_key);
	if (err != 0) {
		LOG_ERR("Failed to initialize Hubble Sat Network");
		goto end;
	}

	for (;;) {
		err = hubble_sat_packet_get(&pkt, NULL, 0);
		if (err != 0) {
			LOG_ERR("Failed to get Hubble Sat Network packet");
			goto end;
		}

		/* Set reliability to NONE - this will trigger a single
		 * transmission instead of a sequence. This is only for testing
		 * purposes and not recommended for production.
		 */
		err = hubble_sat_packet_send(&pkt, HUBBLE_SAT_RELIABILITY_NONE);
		if (err != 0) {
			LOG_ERR("Failed to transmit packet");
			goto end;
		}

		k_sleep(K_SECONDS(CONFIG_SAMPLE_SAT_TX_INTERVAL_SECONDS));
	}

end:
	return err;
}
```
