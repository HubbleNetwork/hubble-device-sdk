## Kconfig
```
# Copyright (c) 2024 Hubble Network, Inc.
# SPDX-License-Identifier: Apache-2.0
#
# This file is the application Kconfig entry point. All application Kconfig
# options can be defined here or included via other application Kconfig files.
# You can browse these options using the west targets menuconfig (terminal) or
# guiconfig (GUI).

menu "Hubble Network Beacon Sample options"


config HUBBLE_BEACON_SAMPLE_ADDITIONAL_ADV
    bool "Enable additional adv in Beacon Sample"
    help
	Enable additional advertisement in the Beacon Sample

if HUBBLE_BEACON_SAMPLE_ADDITIONAL_ADV

config HUBBLE_BEACON_SAMPLE_ADDITIONAL_ADV_UUID
    hex "Additional adv uuid"
    default 0xefbe
    help
	UUID to be advertised

config HUBBLE_BEACON_SAMPLE_ADDITIONAL_ADV_DATA
    hex "Additional adv data"
    default 0xefbeadde
    help
	Data to be advertised
endif

config HUBBLE_BEACON_SAMPLE_USE_CTS
    bool "Use CTS to sync Unix time"
    default n
    select BT_CTS
    select BT_CTS_HELPER_API
    help
       Use CTS to sync time instead of hardcode during building.

config HUBBLE_BEACON_SAMPLE_UPDATE_ADV_PERIOD
    int "Period to update the advertisment packet"
    default 360
    help
	Period (in seconds) to generate a new advertisement message.

endmenu

# Hidden option
config HUBBLE_BEACON_SAMPLE_STORE_NONCE_SEQUENCE
     bool
     default y if NVS
     select HUBBLE_NETWORK_SEQUENCE_NONCE_CUSTOM

source "Kconfig.zephyr"

module = APP
module-str = APP
source "subsys/logging/Kconfig.template.log_config"
```

## sample.yaml
```
# This file is provided so that the application can be compiled using Twister,
# the Zephyr testing tool.

sample:
  description: Hubble Network Bluetooth Beacon example
  name: hubble-ble-network-beacon
common:
  build_only: true
  depends_on:
    - bluetooth
  integration_platforms:
    - nrf52840dk/nrf52840
tests:
  app.beacon.default: {}
  app.beacon.128key:
    extra_configs:
      - CONFIG_HUBBLE_NETWORK_KEY_128=y
  app.beacon.debug:
    extra_overlay_confs:
      - debug.conf
  app.beacon.mbedtls:
    extra_configs:
      - CONFIG_HUBBLE_NETWORK_CRYPTO_MBEDTLS=y
  app.beacon.mbedtls_128key:
    extra_configs:
      - CONFIG_HUBBLE_NETWORK_CRYPTO_MBEDTLS=y
      - CONFIG_HUBBLE_NETWORK_KEY_128=y
```

## prj.conf
```kconfig
# Copyright (c) 2025 Hubble Network, Inc.
# SPDX-License-Identifier: Apache-2.0

# Hubble Network
CONFIG_HUBBLE_BLE_NETWORK=y

# Bluetooth dependencies
CONFIG_BT=y
CONFIG_BT_PERIPHERAL=y

# Default BLE Tx power: 0 dBm
CONFIG_BT_CTLR_TX_PWR_0=y

CONFIG_MAIN_STACK_SIZE=2048

# Enable NVS to persist sequence number
CONFIG_FLASH=y
CONFIG_NVS=y
```

## src/main.c
```c
/*
 * Copyright (c) 2025 Hubble Network, Inc.
 * SPDX-License-Identifier: Apache-2.0
 */

#include <hubble/hubble.h>

#include <zephyr/kernel.h>
#include <zephyr/bluetooth/bluetooth.h>
#ifdef CONFIG_HUBBLE_BEACON_SAMPLE_USE_CTS
#include <zephyr/bluetooth/services/cts.h>
#include <zephyr/bluetooth/conn.h>
#include <zephyr/bluetooth/uuid.h>
#endif /* CONFIG_HUBBLE_BEACON_SAMPLE_USE_CTS */
#include <zephyr/logging/log.h>

#include <stdint.h>
#include <stdlib.h>

#ifdef CONFIG_HUBBLE_NETWORK_CRYPTO_PSA_USE_KEY_ID
#include "key_id.c"
#else
#include "key.c"
#endif /* CONFIG_HUBBLE_NETWORK_CRYPTO_PSA_USE_KEY_ID */

#include "time.c"

LOG_MODULE_REGISTER(main, CONFIG_APP_LOG_LEVEL);


// Buffer used for Hubble data
// Encrypted data will go in here for the advertisement.
#define HUBBLE_USER_BUFFER_LEN 31
static uint8_t _hubble_user_buffer[HUBBLE_USER_BUFFER_LEN];

/* Converts milliseconds to advertising interval units of 0.625 ms. */
#define MS_TO_ADV_INTERVAL(_ms) ((_ms) * 1000U / 625U)

#define ADV_INTERVAL_MIN_MS     1000U
#define ADV_INTERVAL_MAX_MS     1200U

#ifdef CONFIG_HUBBLE_BEACON_SAMPLE_ADDITIONAL_ADV
static struct {
	uint16_t uuid;
	uint32_t data;
} __packed app_adv_data = {
	.uuid = CONFIG_HUBBLE_BEACON_SAMPLE_ADDITIONAL_ADV_UUID,
	.data = CONFIG_HUBBLE_BEACON_SAMPLE_ADDITIONAL_ADV_DATA,
};
#ifdef CONFIG_HUBBLE_BEACON_SAMPLE_USE_CTS
static uint16_t app_adv_uuids[3] = {
	HUBBLE_BLE_UUID,
	CONFIG_HUBBLE_BEACON_SAMPLE_ADDITIONAL_ADV_UUID,
	BT_UUID_CTS_VAL,
};
#else
static uint16_t app_adv_uuids[2] = {
	HUBBLE_BLE_UUID,
	CONFIG_HUBBLE_BEACON_SAMPLE_ADDITIONAL_ADV_UUID,
};
#endif /* CONFIG_HUBBLE_BEACON_SAMPLE_USE_CTS */
static struct bt_data app_ad[3] = {
	BT_DATA(BT_DATA_UUID16_ALL, &app_adv_uuids, sizeof(app_adv_uuids)),
	{},
	BT_DATA(BT_DATA_SVC_DATA16, &app_adv_data, sizeof(app_adv_data)),
};
#else
#ifdef CONFIG_HUBBLE_BEACON_SAMPLE_USE_CTS
static uint16_t app_adv_uuids[2] = {
	HUBBLE_BLE_UUID,
	BT_UUID_CTS_VAL,
};
#else
static uint16_t app_adv_uuids = HUBBLE_BLE_UUID;
#endif /* CONFIG_HUBBLE_BEACON_SAMPLE_USE_CTS */
static struct bt_data app_ad[2] = {
	BT_DATA(BT_DATA_UUID16_ALL, &app_adv_uuids, sizeof(app_adv_uuids)),
	{},
};
#endif /* CONFIG_HUBBLE_BEACON_SAMPLE_ADDITIONAL_ADV */

K_SEM_DEFINE(timer_sem, 0, 1);

static void timer_cb(struct k_timer *timer)
{
	ARG_UNUSED(timer);

	k_sem_give(&timer_sem);
}

K_TIMER_DEFINE(message_timer, timer_cb, NULL);


#ifdef CONFIG_HUBBLE_BEACON_SAMPLE_USE_CTS

/* Lets use 0xFCA7 UUID for when it is connectable. Since this UUID is also
 * assigned to Hubble. This way it is easy to distinguish between a device
 * that is properly beaconing from one that needs time synchronization.
 */
#define HUBBLE_BLE_UUID_SYNC 0xFCA7

static int ble_adv_time_sync(void)
{
	int err;

	*(uint16_t *)&app_adv_uuids = HUBBLE_BLE_UUID_SYNC;

	app_ad[1].data_len = sizeof(uint16_t);
	app_ad[1].type = BT_DATA_SVC_DATA16;
	app_ad[1].data = (uint8_t *)&app_adv_uuids;

	err = bt_le_adv_start(
		BT_LE_ADV_PARAM(BT_LE_ADV_OPT_USE_NRPA | BT_LE_ADV_OPT_CONN,
				BT_GAP_ADV_FAST_INT_MIN_2,
				BT_GAP_ADV_FAST_INT_MAX_2, NULL),
		app_ad, ARRAY_SIZE(app_ad), NULL, 0);

	return err;
}

static void ble_work_handler(struct k_work *work)
{
	ble_adv_time_sync();
}

K_WORK_DEFINE(ble_work, ble_work_handler);
K_SEM_DEFINE(time_sem, 0, 1);

static int bt_cts_cts_time_write(struct bt_cts_time_format *cts_time)
{
	return bt_cts_time_to_unix_ms(cts_time, &unix_time);
}

int bt_cts_fill_current_cts_time(struct bt_cts_time_format *cts_time)
{
	return bt_cts_time_from_unix_ms(cts_time, unix_time + k_uptime_get());
}

static void disconnected(struct bt_conn *conn, uint8_t reason)
{
	if (unix_time != 0U) {
		k_sem_give(&time_sem);
	} else {
		k_work_submit(&ble_work);
	}
}

BT_CONN_CB_DEFINE(conn_callbacks) = {
	.disconnected = disconnected,
};

const struct bt_cts_cb cts_cb = {
	.cts_time_write = bt_cts_cts_time_write,
	.fill_current_cts_time = bt_cts_fill_current_cts_time,
};

static int hubble_ble_time_sync(void)
{
	int ret = 0;

	/* Lets ensure that unix_time is not set */
	unix_time = 0U;

	bt_cts_init(&cts_cb);

	ret = ble_adv_time_sync();
	if (ret != 0) {
		return ret;
	}

	k_sem_take(&time_sem, K_FOREVER);

	/* Get back to 0xFCA6 for future regular advertisements */
	*(uint16_t *)&app_adv_uuids = HUBBLE_BLE_UUID;

	/* We no longer need to advertise CTS service */
	app_ad[0].data_len = sizeof(uint16_t) * (ARRAY_SIZE(app_adv_uuids) - 1);
	app_ad[0].type = BT_DATA_UUID16_ALL;
	app_ad[0].data = (uint8_t *)&app_adv_uuids;

	return ret;
}

#endif /* CONFIG_HUBBLE_BEACON_SAMPLE_USE_CTS */

int main(void)
{
	int err = 0;
	size_t out_len;

	LOG_DBG("Hubble Network BLE Beacon started");

	/* Synchrounosly initialize the Bluetooth subsystem. */
	err = bt_enable(NULL);
	if (err != 0) {
		LOG_ERR("Bluetooth init failed (err %d)", err);
		return err;
	}

#ifdef CONFIG_HUBBLE_BEACON_SAMPLE_USE_CTS
	err = hubble_ble_time_sync();
	if (err != 0) {
		LOG_ERR("Could not get unix_time time synced !");
		goto end;
	}
#endif /* CONFIG_HUBBLE_BEACON_SAMPLE_USE_CTS */

	err = hubble_init(unix_time, master_key);
	if (err != 0) {
		LOG_ERR("Failed to initialize Hubble BLE Network");
		goto end;
	}

	k_timer_start(&message_timer,
		      K_SECONDS(CONFIG_HUBBLE_BEACON_SAMPLE_UPDATE_ADV_PERIOD),
		      K_SECONDS(CONFIG_HUBBLE_BEACON_SAMPLE_UPDATE_ADV_PERIOD));

	for (;;) {
		out_len = HUBBLE_USER_BUFFER_LEN;
		err = hubble_ble_advertise_get(NULL, 0, _hubble_user_buffer,
					       &out_len);
		if (err != 0) {
			LOG_ERR("Failed to get the advertisement data (err=%d)",
				err);
			goto end;
		}
		app_ad[1].data_len = out_len;
		app_ad[1].type = BT_DATA_SVC_DATA16;
		app_ad[1].data = _hubble_user_buffer;

		LOG_DBG("Number of bytes in advertisement: %d", out_len);

		err = bt_le_adv_start(
			BT_LE_ADV_PARAM(BT_LE_ADV_OPT_USE_NRPA,
					MS_TO_ADV_INTERVAL(ADV_INTERVAL_MIN_MS),
					MS_TO_ADV_INTERVAL(ADV_INTERVAL_MAX_MS),
					NULL),
			app_ad, ARRAY_SIZE(app_ad), NULL, 0);
		if (err != 0) {
			LOG_ERR("Bluetooth advertisement failed (err %d)", err);
			goto end;
		}

		k_sem_take(&timer_sem, K_FOREVER);

		err = bt_le_adv_stop();
		if (err != 0) {
			LOG_ERR("Bluetooth advertisement stop failed (err %d)",
				err);
			goto end;
		}
	}

end:
	(void)bt_disable();
	return err;
}
```

## src/epoch.c
```c
static uint64_t unix_epoch_ms;
```

## src/store.c
```c
/*
 * Copyright (c) 2025 Hubble Network, Inc.
 * SPDX-License-Identifier: Apache-2.0
 */

#include <zephyr/kernel.h>
#include <zephyr/device.h>
#include <zephyr/drivers/flash.h>
#include <zephyr/storage/flash_map.h>

#include <zephyr/version.h>

#define NVS_PARTITION        storage_partition

#if KERNEL_VERSION_NUMBER >= ZEPHYR_VERSION(4, 4, 0)
#include <zephyr/kvss/nvs.h>

#define NVS_PARTITION_DEVICE PARTITION_DEVICE(NVS_PARTITION)
#define NVS_PARTITION_OFFSET PARTITION_OFFSET(NVS_PARTITION)

#else

#include <zephyr/fs/nvs.h>

#define NVS_PARTITION_DEVICE FIXED_PARTITION_DEVICE(NVS_PARTITION)
#define NVS_PARTITION_OFFSET FIXED_PARTITION_OFFSET(NVS_PARTITION)

#endif /* KERNEL_VERSION_NUMBER >= ZEPHYR_VERSION(4, 4, 0)  */

#include <hubble/port/crypto.h>
#include <hubble/port/sys.h>

#define SEQUENCE_COUNTER_ID  1U
#define NVS_SECTOR_COUNT     2U

static struct nvs_fs beacon_fs = {
	.flash_device = NVS_PARTITION_DEVICE,
	.offset = NVS_PARTITION_OFFSET,
};

static int beacon_nvs_init(void)
{
	int ret;
	struct flash_pages_info info;

	if (!device_is_ready(beacon_fs.flash_device)) {
		return 0;
	}

	ret = flash_get_page_info_by_offs(beacon_fs.flash_device,
					  beacon_fs.offset, &info);
	if (ret != 0) {
		return ret;
	}

	beacon_fs.sector_size = info.size;
	beacon_fs.sector_count = NVS_SECTOR_COUNT;

	return nvs_mount(&beacon_fs);
}

uint16_t hubble_sequence_counter_get(void)
{
	ssize_t ret;
	uint16_t counter = 0U;

	ret = nvs_read(&beacon_fs, SEQUENCE_COUNTER_ID, &counter,
		       sizeof(counter));
	if (ret != sizeof(counter)) {
		if (ret == -ENOENT) {
			goto end;
		}

		return 0;
	}

	if (counter > HUBBLE_MAX_SEQ_COUNTER) {
		counter = 0U;
	}

end:
	(void)nvs_write(&beacon_fs, SEQUENCE_COUNTER_ID,
			&(uint16_t){counter + 1}, sizeof(counter));

	return counter;
}

SYS_INIT(beacon_nvs_init, APPLICATION, CONFIG_KERNEL_INIT_PRIORITY_DEFAULT);
```

## src/time.c
```c
static uint64_t unix_time;
```
