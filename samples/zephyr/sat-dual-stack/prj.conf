## CMakeLists.txt
```
# Copyright (c) 2026 Hubble Network, Inc.
# SPDX-License-Identifier: Apache-2.0

cmake_minimum_required(VERSION 3.13.1)
find_package(Zephyr REQUIRED HINTS $ENV{ZEPHYR_BASE})

project(app LANGUAGES C)

target_sources(app PRIVATE src/main.c src/app_ble.c)
```

## Kconfig
```
# Copyright (c) 2026 Hubble Network, Inc.
# SPDX-License-Identifier: Apache-2.0

menu "Hubble Network Dual Stack Sample options"

config HUBBLE_DEVICE_KEY
    string "Cryptography key in base64"
    default ""
    help
	Hubble device's cryptographic key

config HUBBLE_SAMPLE_DEBUG
    bool "Enable debug mode"
    default n
    help
	Enable debug mode for the Hubble sample application.
	This will set the sat timer for 2 minutes instead
	of until a satellite pass is overhead.

config SAMPLE_PROVIDE_SAT_BOARD_SUPPORT
    bool "Provide satellite board suport for test purpose"
    help
	Targets that don't support satellite must select it.

endmenu

source "Kconfig.zephyr"

module = APP
module-str = APP
source "subsys/logging/Kconfig.template.log_config"
```

## sample.yaml
```
# Copyright (c) 2026 Hubble Network, Inc.
# SPDX-License-Identifier: Apache-2.0

sample:
  description: Hubble Network dual-stack (BLE beacon + satellite) example
  name: hubble-sat-dual-stack
common:
  build_only: true
  platform_allow:
    - nrf21540dk/nrf52840
    - thingy53/nrf5340/cpunet
    - nrf54l15dk/nrf54l15/cpuapp
    - xiao_mg24
  tags:
    - bluetooth
    - satellite
tests:
  app.sat.dual_stack.default:
      extra_configs:
      - CONFIG_SAMPLE_PROVIDE_SAT_BOARD_SUPPORT=n
  app.sat.dual_stack.debug:
    extra_configs:
      - CONFIG_HUBBLE_SAMPLE_DEBUG=y
  app.sat.dual_stack.128key:
    extra_configs:
      - CONFIG_HUBBLE_NETWORK_KEY_128=y
  app.sat.dual_stack.mbedtls:
    extra_configs:
      - CONFIG_HUBBLE_NETWORK_CRYPTO_MBEDTLS=y
  app.sat.dual_stack.no_board:
    extra_configs:
      - CONFIG_SAMPLE_PROVIDE_SAT_BOARD_SUPPORT=y
    platform_allow:
      - native_sim
  app.sat.dual_stack.mbedtls_128key:
    extra_configs:
      - CONFIG_HUBBLE_NETWORK_CRYPTO_MBEDTLS=y
      - CONFIG_HUBBLE_NETWORK_KEY_128=y
  app.sat.dual_stack.ncs:
    extra_configs:
      - CONFIG_SAMPLE_PROVIDE_SAT_BOARD_SUPPORT=n
    modules:
      - nrf
    tags:
      - ncs
    required_snippets:
      - ncs-dual-stack
    platform_exclude:
      - native_sim
    platform_allow:
      - nrf21540dk/nrf52840
    integration_platforms:
      - nrf21540dk/nrf52840
  app.sat.dual_stack.host_integration:
    extra_configs:
      - CONFIG_SAMPLE_PROVIDE_SAT_BOARD_SUPPORT=n
    tags:
      - host_integration
    integration_platforms:
      - thingy53/nrf5340/cpunet
```

## prj.conf
```kconfig
# Copyright (c) 2026 Hubble Network, Inc.
# SPDX-License-Identifier: Apache-2.0

# Hubble Network
CONFIG_HUBBLE_BLE_NETWORK=y
CONFIG_HUBBLE_SAT_NETWORK=y

# Bluetooth dependencies
CONFIG_BT=y
CONFIG_BT_PERIPHERAL=y
CONFIG_BT_DEVICE_NAME="Hubble-Zephyr"

# Default BLE Tx power: 0 dBm
CONFIG_BT_CTLR_TX_PWR_0=y

# Allow large GATT writes, the orbital params command is 78 bytes
CONFIG_BT_L2CAP_TX_MTU=247
CONFIG_BT_BUF_ACL_RX_SIZE=251
CONFIG_BT_BUF_ACL_TX_SIZE=251

# Used to decode the device key
CONFIG_BASE64=y

# The next satellite pass may be more than 18 hours away
CONFIG_TIMEOUT_64BIT=y

CONFIG_LOG=y
CONFIG_MAIN_STACK_SIZE=4096
```

## boards/nrf21540dk.conf
```kconfig
CONFIG_NRFX_TIMER=y
CONFIG_BT_CTLR_ADVANCED_FEATURES=y
CONFIG_BT_CTLR_DYNAMIC_INTERRUPTS=y
CONFIG_DYNAMIC_INTERRUPTS=y
CONFIG_DYNAMIC_DIRECT_INTERRUPTS=y
CONFIG_SHARED_INTERRUPTS=y
CONFIG_SAMPLE_PROVIDE_SAT_BOARD_SUPPORT=n
```

## boards/nrf54l15dk_nrf54l15_cpuapp-softdevice.conf
```kconfig
CONFIG_SAMPLE_PROVIDE_SAT_BOARD_SUPPORT=n

CONFIG_MPSL=y
CONFIG_MPSL_TIMESLOT_SESSION_COUNT=1
```

## boards/thingy53_nrf5340_cpunet.conf
```kconfig
CONFIG_SAMPLE_PROVIDE_SAT_BOARD_SUPPORT=n
```

## boards/xiao_mg24.conf
```kconfig
CONFIG_SOC_GECKO_CUSTOM_RADIO_PHY=y
CONFIG_SILABS_SISDK_RAIL_MULTIPROTOCOL=y
CONFIG_SAMPLE_PROVIDE_SAT_BOARD_SUPPORT=n
```

## src/main.c
```c
/*
 * Copyright (c) 2026 Hubble Network, Inc.
 *
 * SPDX-License-Identifier: Apache-2.0
 */

#include <hubble/hubble.h>
#include <hubble/sat/packet.h>
#include <hubble/sat/pass_prediction.h>

#include <zephyr/kernel.h>
#include <zephyr/logging/log.h>
#include <zephyr/sys/base64.h>

#include <stdint.h>
#include <string.h>

#include "app_ble.h"

LOG_MODULE_REGISTER(main, CONFIG_APP_LOG_LEVEL);

#define HUBBLE_MAX_SAT 6U

struct hubble_sat_orbital_params orb_params[HUBBLE_MAX_SAT];
struct hubble_sat_device_pos device_pos;
uint8_t orb_params_count;
uint64_t unix_time_ms;

/* Hubble device key, decoded from CONFIG_HUBBLE_DEVICE_KEY. */
static uint8_t _hubble_key[CONFIG_HUBBLE_KEY_SIZE];

/* Given by app_ble.c once provisioning (time + orbital params) completes. */
K_SEM_DEFINE(sync_sem, 0, 1);

/* Given by the satellite-pass timer when it is time to transmit. */
static K_SEM_DEFINE(sat_tx_sem, 0, 1);

static void _sat_timer_cb(struct k_timer *timer)
{
	ARG_UNUSED(timer);

	k_sem_give(&sat_tx_sem);
}

static K_TIMER_DEFINE(sat_timer, _sat_timer_cb, NULL);

#ifdef CONFIG_SAMPLE_PROVIDE_SAT_BOARD_SUPPORT

int hubble_sat_board_init(void)
{
	return 0;
}

int hubble_sat_board_enable(void)
{
	return 0;
}

int hubble_sat_board_disable(void)
{
	return 0;
}

int hubble_sat_board_packet_send(const struct hubble_sat_packet_frames *packet)
{
	ARG_UNUSED(packet);

	return 0;
}

#endif /* CONFIG_SAMPLE_PROVIDE_SAT_BOARD_SUPPORT */

int main(void)
{
	struct hubble_sat_pass_info pass_info = {0};
	struct hubble_sat_packet packet = {0};
	uint64_t now_ms;
	int err;

	LOG_INF("Hubble Network dual-stack sample started");

	/* Decode the device key, if one was provided at build time. */
	if (strlen(CONFIG_HUBBLE_DEVICE_KEY) != 0) {
		size_t olen;

		err = base64_decode(_hubble_key, sizeof(_hubble_key), &olen,
				    CONFIG_HUBBLE_DEVICE_KEY,
				    strlen(CONFIG_HUBBLE_DEVICE_KEY));
		if (err != 0) {
			LOG_ERR("Invalid key provided!");
			return -EINVAL;
		}
	}

	/*
	 * Enable BLE and start connectable advertising.
	 */
	err = ble_init();
	if (err != 0) {
		LOG_ERR("Failed to init BLE (err %d)", err);
		return err;
	}

	LOG_INF("Waiting for provisioning over BLE...");
	k_sem_take(&sync_sem, K_FOREVER);

	err = hubble_init(unix_time_ms, 0, _hubble_key);
	if (err != 0) {
		LOG_ERR("Failed to initialize Hubble Network (err %d)", err);
		return err;
	}

	err = hubble_sat_satellites_set(orb_params, orb_params_count);
	if (err != 0) {
		LOG_ERR("Failed to set satellite orbital params (err %d)", err);
		return err;
	}

	LOG_INF("Hubble Network initialized with %u satellite(s)",
		orb_params_count);

	for (;;) {
		/* Compute the next satellite pass over the device location. */
		now_ms = hubble_time_get();

		err = hubble_sat_next_pass_get(now_ms, &device_pos, &pass_info);
		if (err != 0) {
			LOG_ERR("Failed to get next pass info (err %d)", err);
			return err;
		}

		/*
		 * A pass start in the past means we are in the middle of a
		 * pass; compute the next one.
		 */
		if (pass_info.start <= now_ms) {
			LOG_INF("Pass ongoing or in the past, finding next...");

			err = hubble_sat_next_pass_get(
				pass_info.start + pass_info.duration,
				&device_pos, &pass_info);
			if (err != 0) {
				LOG_ERR("Failed to get next pass info (err %d)",
					err);
				return err;
			}
		}

#ifdef CONFIG_HUBBLE_SAMPLE_DEBUG
		LOG_INF("Debug mode: next pass in 120 seconds");
		k_timer_start(&sat_timer, K_SECONDS(120), K_NO_WAIT);
#else
		LOG_INF("Next pass at %llu (unix epoch seconds)",
			pass_info.start / MSEC_PER_SEC);
		k_timer_start(&sat_timer, K_MSEC(pass_info.start - now_ms),
			      K_NO_WAIT);
#endif

		err = ble_adv_start();
		if (err != 0) {
			LOG_ERR("Failed to start beacon adv (err %d)", err);
			return err;
		}
		LOG_INF("Beaconing until next pass...");

		k_sem_take(&sat_tx_sem, K_FOREVER);

		/* Stop the beacon and transmit to the satellite. */
		err = ble_adv_stop();
		if (err != 0) {
			LOG_ERR("Failed to stop beacon adv (err %d)", err);
			return err;
		}

		err = hubble_sat_packet_get(&packet, NULL, 0);
		if (err != 0) {
			LOG_ERR("Failed to get sat packet (err %d)", err);
			return err;
		}

		LOG_INF("Transmitting to satellite...");
		err = hubble_sat_packet_send(&packet,
					     HUBBLE_SAT_RELIABILITY_NORMAL);
		if (err != 0) {
			LOG_ERR("Failed to send sat packet (err %d)", err);
			return err;
		}
	}

	return 0;
}
```

## src/app_ble.c
```c
/*
 * Copyright (c) 2026 Hubble Network, Inc.
 *
 * SPDX-License-Identifier: Apache-2.0
 */

#include <hubble/hubble.h>
#include <hubble/ble.h>
#include <hubble/sat/pass_prediction.h>

#include <zephyr/kernel.h>
#include <zephyr/bluetooth/bluetooth.h>
#include <zephyr/bluetooth/conn.h>
#include <zephyr/bluetooth/gatt.h>
#include <zephyr/bluetooth/uuid.h>
#include <zephyr/logging/log.h>
#include <zephyr/sys/byteorder.h>

#include <stdint.h>
#include <string.h>

#include "app_ble.h"

LOG_MODULE_REGISTER(app_ble, CONFIG_APP_LOG_LEVEL);

/*
 * 0xFCA7 is the UUID advertised while the device is connectable and waiting to
 * be provisioned. It distinguishes a device that still needs time / orbital
 * parameters from one that is properly beaconing the Hubble UUID (0xFCA6).
 */
#define HUBBLE_BLE_UUID_PROVISION      0xFCA7

/* Buffer used for the Hubble beacon advertisement payload. */
#define HUBBLE_BLE_BUFFER_LEN          31U

#define HUBBLE_CMD                     0x01
#define HUBBLE_CMD_UNIX_EPOCH          0x02
#define HUBBLE_CMD_ORBITAL_PARAMS      0x03
#define HUBBLE_CMD_DEVICE_LOCATION     0x04
#define HUBBLE_ORBITAL_PARAMS_CMD_SIZE 76U
#define HUBBLE_MAX_SAT                 6U

/* Period to refresh the beacon advertisement payload (1 hour). */
#define HUBBLE_ADV_REFRESH_PERIOD      K_HOURS(1)

/* Converts milliseconds to advertising interval units of 0.625 ms. */
#define MS_TO_ADV_INTERVAL(_ms)        ((_ms) * 1000U / 625U)

#define ADV_INTERVAL_MIN_MS            1000U
#define ADV_INTERVAL_MAX_MS            1200U

/*
 *   Service:        0000fca7-0000-1000-8000-00805f9b34fb
 *   Characteristic: 00000005-fca7-4000-8000-00805f9b34fb
 */
#define HUBBLE_PROV_SVC_UUID                                                   \
	BT_UUID_DECLARE_128(BT_UUID_128_ENCODE(0x0000fca7, 0x0000, 0x1000,     \
					       0x8000, 0x00805f9b34fb))
#define HUBBLE_PROV_CHR_UUID                                                   \
	BT_UUID_DECLARE_128(BT_UUID_128_ENCODE(0x00000005, 0xfca7, 0x4000,     \
					       0x8000, 0x00805f9b34fb))

/*
 * Provisioning data lives in main.c
 */
extern struct hubble_sat_orbital_params orb_params[];
extern struct hubble_sat_device_pos device_pos;
extern uint8_t orb_params_count;
extern uint64_t unix_time_ms;

/* Given once provisioning completes (time received and peer disconnected). */
extern struct k_sem sync_sem;

/* Hubble beacon advertisement state. */
static uint16_t _beacon_uuid = HUBBLE_BLE_UUID;
static uint8_t _beacon_buffer[HUBBLE_BLE_BUFFER_LEN];
static struct bt_data _beacon_ad[] = {
	BT_DATA(BT_DATA_UUID16_ALL, &_beacon_uuid, sizeof(_beacon_uuid)),
	/* svc data, set at runtime in _beacon_data_update() */
	BT_DATA(BT_DATA_SVC_DATA16, _beacon_buffer, sizeof(_beacon_buffer)),
};

/* Connectable provisioning advertisement. */
static const struct bt_data _prov_ad[] = {
	BT_DATA_BYTES(BT_DATA_UUID16_ALL,
		      BT_UUID_16_ENCODE(HUBBLE_BLE_UUID_PROVISION)),
	BT_DATA(BT_DATA_NAME_COMPLETE, CONFIG_BT_DEVICE_NAME,
		sizeof(CONFIG_BT_DEVICE_NAME) - 1),
};

/* Fetch a fresh Hubble beacon payload into the advertisement data set. */
static int _beacon_data_update(void)
{
	size_t out_len = sizeof(_beacon_buffer);
	int err;

	memset(_beacon_buffer, 0, sizeof(_beacon_buffer));
	err = hubble_ble_advertise_get(NULL, 0, _beacon_buffer, &out_len);
	if (err != 0) {
		LOG_ERR("Failed to get Hubble adv data (err=%d)", err);
		return err;
	}

	_beacon_ad[1].data_len = out_len;

	return 0;
}

static void _adv_refresh_work_handler(struct k_work *work)
{
	ARG_UNUSED(work);

	if (_beacon_data_update() != 0) {
		return;
	}

	(void)bt_le_adv_update_data(_beacon_ad, ARRAY_SIZE(_beacon_ad), NULL, 0);
}

static K_WORK_DEFINE(_adv_refresh_work, _adv_refresh_work_handler);

static void _adv_refresh_timer_cb(struct k_timer *timer)
{
	ARG_UNUSED(timer);

	k_work_submit(&_adv_refresh_work);
}

static K_TIMER_DEFINE(_adv_refresh_timer, _adv_refresh_timer_cb, NULL);

int ble_adv_start(void)
{
	int err;

	if (!bt_is_ready()) {
		err = bt_enable(NULL);
		if (err != 0) {
			return err;
		}
	}

	err = _beacon_data_update();
	if (err != 0) {
		return err;
	}
	LOG_DBG("Beacon advertisement payload: %d bytes", _beacon_ad[1].data_len);

	err = bt_le_adv_start(
		BT_LE_ADV_PARAM(BT_LE_ADV_OPT_USE_NRPA,
				MS_TO_ADV_INTERVAL(ADV_INTERVAL_MIN_MS),
				MS_TO_ADV_INTERVAL(ADV_INTERVAL_MAX_MS), NULL),
		_beacon_ad, ARRAY_SIZE(_beacon_ad), NULL, 0);
	if (err != 0) {
		LOG_ERR("Failed to start beacon adv (err=%d)", err);
		return err;
	}

	k_timer_start(&_adv_refresh_timer, HUBBLE_ADV_REFRESH_PERIOD,
		      HUBBLE_ADV_REFRESH_PERIOD);

	return 0;
}

int ble_adv_stop(void)
{
	k_timer_stop(&_adv_refresh_timer);
	bt_le_adv_stop();
	return bt_disable();
}

static ssize_t _prov_write(struct bt_conn *conn,
			   const struct bt_gatt_attr *attr, const void *buf,
			   uint16_t len, uint16_t offset, uint8_t flags)
{
	const uint8_t *data = buf;

	ARG_UNUSED(conn);
	ARG_UNUSED(attr);
	ARG_UNUSED(flags);

	if (offset != 0) {
		return BT_GATT_ERR(BT_ATT_ERR_INVALID_OFFSET);
	}

	if (len < 2 || data[0] != HUBBLE_CMD) {
		return BT_GATT_ERR(BT_ATT_ERR_NOT_SUPPORTED);
	}

	switch (data[1]) {
	case HUBBLE_CMD_UNIX_EPOCH:
		if (len != (2 + sizeof(uint64_t))) {
			return BT_GATT_ERR(BT_ATT_ERR_INVALID_ATTRIBUTE_LEN);
		}

		memcpy(&unix_time_ms, &data[2], sizeof(unix_time_ms));
		LOG_INF("Received unix time: %llu", unix_time_ms);
		break;

	case HUBBLE_CMD_ORBITAL_PARAMS:
		struct hubble_sat_orbital_params *dst;
		const uint8_t *p = &data[2];

		if (len != (2 + HUBBLE_ORBITAL_PARAMS_CMD_SIZE)) {
			return BT_GATT_ERR(BT_ATT_ERR_INVALID_ATTRIBUTE_LEN);
		}

		if (orb_params_count >= HUBBLE_MAX_SAT) {
			LOG_WRN("Max satellite count reached, ignoring params");
			break;
		}

		dst = &orb_params[orb_params_count];

		/* Copy field by field to avoid alignment issues. */
		memcpy(&dst->t0, p, sizeof(uint64_t));
		memcpy(&dst->n0, p + 8, sizeof(double));
		memcpy(&dst->ndot, p + 16, sizeof(double));
		memcpy(&dst->raan0, p + 24, sizeof(double));
		memcpy(&dst->raandot, p + 32, sizeof(double));
		memcpy(&dst->aop0, p + 40, sizeof(double));
		memcpy(&dst->aopdot, p + 48, sizeof(double));
		memcpy(&dst->inclination, p + 56, sizeof(double));
		memcpy(&dst->eccentricity, p + 64, sizeof(double));
		memcpy(&dst->satellite_id, p + 72, sizeof(uint32_t));

		orb_params_count++;
		LOG_INF("Received orbital params for satellite ID %u",
			dst->satellite_id);
		break;

	case HUBBLE_CMD_DEVICE_LOCATION:
		if (len != (2 + 2 * sizeof(double))) {
			return BT_GATT_ERR(BT_ATT_ERR_INVALID_ATTRIBUTE_LEN);
		}
		memcpy(&device_pos.lat, &data[2], sizeof(double));
		memcpy(&device_pos.lon, &data[2] + sizeof(double),
		       sizeof(double));
		break;
	default:
		return BT_GATT_ERR(BT_ATT_ERR_NOT_SUPPORTED);
	}

	return len;
}

/* Provisioning GATT service. */
BT_GATT_SERVICE_DEFINE(
	hubble_prov_svc, BT_GATT_PRIMARY_SERVICE(HUBBLE_PROV_SVC_UUID),
	BT_GATT_CHARACTERISTIC(HUBBLE_PROV_CHR_UUID,
			       BT_GATT_CHRC_WRITE | BT_GATT_CHRC_WRITE_WITHOUT_RESP,
			       BT_GATT_PERM_WRITE, NULL, _prov_write, NULL), );

static int _start_provisioning_adv(void)
{
	int err;

	err = bt_le_adv_start(
		BT_LE_ADV_PARAM(BT_LE_ADV_OPT_USE_NRPA | BT_LE_ADV_OPT_CONN,
				BT_GAP_ADV_FAST_INT_MIN_2,
				BT_GAP_ADV_FAST_INT_MAX_2, NULL),
		_prov_ad, ARRAY_SIZE(_prov_ad), NULL, 0);
	if (err != 0) {
		LOG_ERR("Failed to start provisioning adv (err=%d)", err);
	}

	return err;
}

static void _prov_restart_work_handler(struct k_work *work)
{
	ARG_UNUSED(work);

	(void)_start_provisioning_adv();
}

static K_WORK_DEFINE(_prov_restart_work, _prov_restart_work_handler);

static void _connected(struct bt_conn *conn, uint8_t err)
{
	ARG_UNUSED(conn);

	if (err != 0) {
		LOG_WRN("Connection failed (err 0x%02x), restarting adv", err);
		k_work_submit(&_prov_restart_work);
		return;
	}

	LOG_DBG("Connected, waiting for provisioning data");
}

static void _disconnected(struct bt_conn *conn, uint8_t reason)
{
	ARG_UNUSED(conn);

	LOG_DBG("Disconnected (reason 0x%02x)", reason);

	if (unix_time_ms != 0U) {
		k_sem_give(&sync_sem);
	} else {
		k_work_submit(&_prov_restart_work);
	}
}

BT_CONN_CB_DEFINE(conn_callbacks) = {
	.connected = _connected,
	.disconnected = _disconnected,
};

int ble_init(void)
{
	int err;

	err = bt_enable(NULL);
	if (err != 0) {
		LOG_ERR("Bluetooth init failed (err %d)", err);
		return err;
	}

	return _start_provisioning_adv();
}
```

## src/app_ble.h
```c
/*
 * Copyright (c) 2026 Hubble Network, Inc.
 *
 * SPDX-License-Identifier: Apache-2.0
 */

#ifndef APP_BLE_H
#define APP_BLE_H

/**
 * @brief Initialize the Bluetooth LE subsystem.
 *
 * Enables the Bluetooth stack, and starts a connectable
 * advertising session that exposes the Hubble provisioning GATT service.
 * Must be called once before any other BLE function.
 *
 * Provisioning data (UTC time and satellite orbital parameters) received over
 * GATT is stored in the @c unix_time_ms / @c orb_params globals owned by the
 * application. Once a peer has written the time and disconnects, @c sync_sem
 * is given so the application can proceed.
 *
 * @return 0 on success, negative errno on failure.
 */
int ble_init(void);

/**
 * @brief Start the Hubble terrestrial beacon advertising.
 *
 * Begins broadcasting non-connectable Hubble beacon packets. The payload is
 * refreshed periodically (hourly). @ref ble_init must have been called
 * successfully before invoking this function.
 *
 * @return 0 on success, negative errno on failure.
 */
int ble_adv_start(void);

/**
 * @brief Stop the Hubble terrestrial beacon advertising.
 *
 * Stop advertisements and the payload refresh timer. Safe to call even
 * if advertising is already stopped.
 *
 * @return 0 on success, negative errno on failure.
 */
int ble_adv_stop(void);

#endif /* APP_BLE_H */
```
