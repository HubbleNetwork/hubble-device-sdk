## samples/esp-idf/ble-beacon/sdkconfig.defaults
```kconfig
# Copyright (c) 2025 Hubble Network, Inc.
# SPDX-License-Identifier: Apache-2.0

CONFIG_BT_ENABLED=y
CONFIG_BT_BLE_50_FEATURES_SUPPORTED=n
CONFIG_BT_BLE_42_FEATURES_SUPPORTED=y

# Default BLE Tx power: 0 dBm
CONFIG_BT_LE_DFT_TX_POWER_LEVEL_N0=y


# Hubble
CONFIG_HUBBLE_BLE_NETWORK=y
```

## samples/freertos/silabs/sat-dual-stack/sample.yaml
```yaml
sample:
  name: sat-dual-stack

builds:
  - id: xg24-brd4187c
    board: brd4187c
  - id: xg26-brd4121a
    board: brd4121a
```

## tests/zephyr/challenge/testcase.yaml
```yaml
common:
  platform_allow:
    - native_sim/native/64
    - nrf52840dk/nrf52840
  tags:
    - hubble
    - security
    - challenge
  integration_platforms:
    - native_sim/native/64

tests:
  hubble.challenge.mbedtls:
    extra_configs:
      - CONFIG_HUBBLE_NETWORK_CRYPTO_MBEDTLS=y
      - CONFIG_HUBBLE_COUNTER_SOURCE_UNIX_TIME=y
  hubble.challenge.psa:
    extra_configs:
      - CONFIG_HUBBLE_NETWORK_CRYPTO_PSA=y
      - CONFIG_HUBBLE_COUNTER_SOURCE_UNIX_TIME=y
  hubble.challenge.counter.mbedtls:
    extra_configs:
      - CONFIG_HUBBLE_NETWORK_CRYPTO_MBEDTLS=y
      - CONFIG_HUBBLE_COUNTER_SOURCE_DEVICE_UPTIME=y
  hubble.challenge.counter.psa:
    extra_configs:
      - CONFIG_HUBBLE_NETWORK_CRYPTO_PSA=y
      - CONFIG_HUBBLE_COUNTER_SOURCE_DEVICE_UPTIME=y
```

## tests/zephyr/sat-api/testcase.yaml
```yaml
common:
  platform_allow:
    - native_sim
    - qemu_cortex_m3
  tags:
    - satellite
    - apis

tests:
  satellite.api:
    extra_configs:
      - CONFIG_HUBBLE_SAT_NETWORK_PROTOCOL_V1=y
  satellite.api.packet_sent_cb:
    extra_configs:
      - CONFIG_HUBBLE_SAT_NETWORK_PROTOCOL_V1=y
      - CONFIG_HUBBLE_SAT_NETWORK_PACKET_SENT_CB=y
  satellite.api.counter.mbedtls:
    extra_configs:
      - CONFIG_HUBBLE_SAT_NETWORK_PROTOCOL_V1=y
      - CONFIG_HUBBLE_NETWORK_CRYPTO_MBEDTLS=y
      - CONFIG_HUBBLE_COUNTER_SOURCE_DEVICE_UPTIME=y
      - CONFIG_HUBBLE_EID_ROTATION_PERIOD_SEC=86400
  satellite.api.counter.psa:
    extra_configs:
      - CONFIG_HUBBLE_SAT_NETWORK_PROTOCOL_V1=y
      - CONFIG_HUBBLE_NETWORK_CRYPTO_PSA=y
      - CONFIG_HUBBLE_COUNTER_SOURCE_DEVICE_UPTIME=y
      - CONFIG_HUBBLE_EID_ROTATION_PERIOD_SEC=86400
```
