## port/esp-idf/hubblenetwork-sdk/Kconfig
```kconfig
# Copyright (c) 2025 Hubble Network, Inc.
# SPDX-License-Identifier: Apache-2.0

config HUBBLE_EID_ROTATION_PERIOD_SEC
	int "EID rotation period in seconds"
	default 86400
	range 86400 86400
	help
	  EID rotation period. Currently only daily rotations
	  are supported (86400)

choice HUBBLE_EID_MODE
	prompt "EID generation mode"
	default HUBBLE_EID_UTC_BASED

config HUBBLE_EID_UTC_BASED
	bool "UTC-based EID generation"
	help
	  EID derived from UTC time. Requires time provisioning.

config HUBBLE_EID_COUNTER_BASED
	bool "Counter-based EID generation"
	help
	  EID derived from internal counter. No UTC time required.
	  Initial counter value provided via hubble_init().

endchoice

config HUBBLE_EID_POOL_SIZE
	int "EID pool size"
	default 32
	range 16 2048
	depends on HUBBLE_EID_COUNTER_BASED
	help
	  Number of unique EIDs in the pool. The counter wraps at this value.
	  Range: 16 to 2048 unique EID epochs.

	  Examples with default rotation period (86400 sec / daily):
	    16:   ~16 days of unique EIDs
	    64:   ~64 days of unique EIDs (default)
	    256:  ~256 days of unique EIDs
	    2048: ~5.6 years of unique EIDs

menuconfig HUBBLE_SAT_NETWORK
	   bool "Hubble Satellite Network Library [EXPERIMENTAL]"
	   help
		Enable library for communication with Hubble network

if HUBBLE_SAT_NETWORK

config HUBBLE_SAT_NETWORK_SMALL
	   bool "Use smaller code size for fly by calculation"
	   help
		Reduces code using polynomial approximation
		for trigonometric functions

config HUBBLE_SAT_NETWORK_DEVICE_TDR
	   int "Device time drift retry rate in PPM"
	   default 500
	   help
		Adds additional retries proportional to time since
		last time the device had utc time synced. It is
		represented in PPM (parts per million).

choice
	prompt "Hubble Sat Network protocol"
	default HUBBLE_SAT_NETWORK_PROTOCOL_V1

config HUBBLE_SAT_NETWORK_PROTOCOL_V1
	   bool "Use V1 protocol"
	   help
		First version of Sat protocol. Channel hopping within transmissions.

config HUBBLE_SAT_NETWORK_PROTOCOL_DEPRECATED
	   bool "Use deprecated protocol"
	   help
		Deprecated version of Sat protocol. No channel hopping during transmissions.
endchoice

endif

menuconfig HUBBLE_BLE_NETWORK
	   bool "Hubble BLE Network Library"
	   help
		Enable library for communication with Hubble BLE network

choice
	prompt "Hubble Network key size"

config HUBBLE_NETWORK_KEY_256
	   bool "Use 256 bits key size"
	   help
		256 bits key size

config HUBBLE_NETWORK_KEY_128
	   bool "Use 128 bits key size"
	   help
		128 bits key size

endchoice

config HUBBLE_KEY_SIZE
	   int
	   default 32 if HUBBLE_NETWORK_KEY_256
	   default 16 if HUBBLE_NETWORK_KEY_128

config HUBBLE_NETWORK_SECURITY_ENFORCE_NONCE_CHECK
	   bool "Enforce check in nonce used in cryptography"
	   default y
	   help
		Ensure that nonce parameters are not re-used
		to encrypt different messages.
		Be aware that re-using the same nonce has severe
		security implications.

config HUBBLE_NETWORK_SEQUENCE_NONCE_CUSTOM
	   bool "Application defined sequence counter"
	   help
		This option allows applications to override the default
		function that returns a sequence number to be used to
		encrypt messages.
```

## port/zephyr/Kconfig.nrf
```kconfig
# Copyright (c) 2026 Hubble Network, Inc.
# SPDX-License-Identifier: Apache-2.0

if SOC_FAMILY_NORDIC_NRF

if HUBBLE_SAT_NETWORK && !HUBBLE_BLE_NETWORK

configdefault NRFX_TIMER
      	default y

endif #HUBBLE_SAT_NETWORK && !HUBBLE_BLE_NETWORK

if !ZEPHYR_NRF_MODULE

if HUBBLE_SAT_NETWORK

configdefault NRFX_TIMER
      	default y

if HUBBLE_BLE_NETWORK

configdefault BT_CTLR_ADVANCED_FEATURES
      	default y

configdefault BT_CTLR_DYNAMIC_INTERRUPTS
      	default y

configdefault DYNAMIC_INTERRUPTS
      	default y

configdefault DYNAMIC_DIRECT_INTERRUPTS
      	default y

configdefault SHARED_INTERRUPTS
      	default y

endif # HUBBLE_BLE_NETWORK

endif # HUBBLE_SAT_NETWORK

endif # !ZEPHYR_NRF_MODULE

endif # SOC_FAMILY_NORDIC_NRF
```

## samples/esp-idf/sat-continuous/main/Kconfig.projbuild
```kconfig
# Copyright (c) 2026 Hubble Network, Inc.
# SPDX-License-Identifier: Apache-2.0

menu "Sat Continuous Sample Configuration"

    orsource "$IDF_PATH/examples/common_components/env_caps/$IDF_TARGET/Kconfig.env_caps"

    config HUBBLE_DEVICE_KEY
    string "Cryptography key in base64"
    default ""
    help
        Hubble device's cryptographic key

endmenu
```

## samples/esp-idf/sat-dtm/sdkconfig.defaults
```kconfig
# Copyright (c) 2026 Hubble Network, Inc.
# SPDX-License-Identifier: Apache-2.0

# Sat dependencies
CONFIG_HUBBLE_SAT_NETWORK=y
CONFIG_HUBBLE_SAT_NETWORK_DTM_MODE=y
CONFIG_ESP_PHY_ENABLE_CERT_TEST=y

# Disable nonce check since we don't need it for DTM
CONFIG_HUBBLE_NETWORK_SECURITY_ENFORCE_NONCE_CHECK=n
```

## samples/freertos/ti/ble-beacon/sample.yaml
```yaml
sample:
  name: ble-beacon

builds:
  - id: default
    makefile: makefile
  - id: SysConfig-based
    makefile: makefile-syscfg
```

## samples/freertos/ti/sat-continuous/sample.yaml
```yaml
sample:
  name: sat-continuous

builds:
  - id: sat-continuous-cc2340r5
    makefile: cc2340r5.mk
  - id: sat-continuous-cc2755p10
    makefile: cc2755p10.mk
```

## samples/freertos/ti/sat-dual-stack/sample.yaml
```yaml
sample:
  name: sat-dual-stack

builds:
  - id: default-cc2755p10
    makefile: cc2755p10.mk
```

## tests/zephyr/ble-network/testcase.yaml
```yaml
common:
  platform_allow:
    - nrf52840dk/nrf52840
    - nrf52_bsim
    - native_sim/native/64
  tags:
    - ble
    - security
    - nonce
  integration_platforms:
    - nrf52840dk/nrf52840

tests:
  ble.nonce:
    extra_configs:
      - CONFIG_HUBBLE_NETWORK_CRYPTO_MBEDTLS=y
      - CONFIG_HUBBLE_COUNTER_SOURCE_UNIX_TIME=y
  ble.nonce.psa:
    extra_configs:
      - CONFIG_HUBBLE_NETWORK_CRYPTO_PSA=y
      - CONFIG_HUBBLE_COUNTER_SOURCE_UNIX_TIME=y
  ble.counter:
    extra_configs:
      - CONFIG_HUBBLE_NETWORK_CRYPTO_MBEDTLS=y
      - CONFIG_HUBBLE_COUNTER_SOURCE_DEVICE_UPTIME=y
      - CONFIG_HUBBLE_EID_ROTATION_PERIOD_SEC=86400
      - CONFIG_HUBBLE_NETWORK_SEQUENCE_NONCE_CUSTOM=y
  ble.counter.psa:
    extra_configs:
      - CONFIG_HUBBLE_NETWORK_CRYPTO_PSA=y
      - CONFIG_HUBBLE_COUNTER_SOURCE_DEVICE_UPTIME=y
      - CONFIG_HUBBLE_EID_ROTATION_PERIOD_SEC=86400
      - CONFIG_HUBBLE_NETWORK_SEQUENCE_NONCE_CUSTOM=y
```

## tests/zephyr/ephemeris/testcase.yaml
```yaml
common:
  platform_allow:
    - native_sim
    - qemu_cortex_m3
  min_flash: 34
  tags:
    - ephemeris
    - satellite
  integration_platforms:
    - native_sim

tests:
  satellite.ephemeris:
    extra_configs:
      - CONFIG_HUBBLE_SAT_NETWORK_SMALL=n
  satellie.ephemeris.small:
    extra_configs:
      - CONFIG_HUBBLE_SAT_NETWORK_SMALL=y
```

## tests/zephyr/hubble-api/testcase.yaml
```yaml
common:
  platform_allow:
    - native_sim
    - qemu_cortex_m3
  tags:
    - hubble
    - apis

tests:
  hubble.api:
    extra_configs:
      - CONFIG_HUBBLE_SAT_NETWORK_PROTOCOL_V1=y
  hubble.api.uptime_counter:
    extra_configs:
      - CONFIG_HUBBLE_SAT_NETWORK_PROTOCOL_V1=y
      - CONFIG_HUBBLE_COUNTER_SOURCE_DEVICE_UPTIME=y
      - CONFIG_HUBBLE_EID_ROTATION_PERIOD_SEC=86400
```

## tests/zephyr/pass-prediction/testcase.yaml
```yaml
common:
  platform_allow:
    - native_sim
    - qemu_cortex_m3
  min_flash: 34
  tags:
    - pass_prediction
    - satellite
  integration_platforms:
    - native_sim

tests:
  satellite.pass_prediction:
    extra_configs:
      - CONFIG_HUBBLE_SAT_NETWORK_SMALL=n
  satellite.pass_prediction.small:
    extra_configs:
      - CONFIG_HUBBLE_SAT_NETWORK_SMALL=y
```

## tests/zephyr/unit/bitarray/testcase.yaml
```yaml
common:
  platform_allow:
    - native_sim
    - native_sim/native/64
    - qemu_cortex_m3

tests:
  utilities.bitarray:
    tags:
      - bitarray
```

## tests/zephyr/unit/ble-advertise/testcase.yaml
```yaml
common:
  platform_allow:
    - native_sim
    - native_sim/native/64
    - qemu_cortex_m3
  tags:
    - ble
    - crypto
    - advertise
    - unit

tests:
  ble.advertise.unit.mbedtls:
    extra_configs:
      - CONFIG_HUBBLE_NETWORK_CRYPTO_MBEDTLS=y

  ble.advertise.unit.psa:
    extra_configs:
      - CONFIG_HUBBLE_NETWORK_CRYPTO_PSA=y

  ble.advertise.unit.counter.mbedtls:
    extra_configs:
      - CONFIG_HUBBLE_NETWORK_CRYPTO_MBEDTLS=y
      - CONFIG_HUBBLE_EID_COUNTER_BASED=y
      - CONFIG_HUBBLE_EID_POOL_SIZE=32

  ble.advertise.unit.counter.psa:
    extra_configs:
      - CONFIG_HUBBLE_NETWORK_CRYPTO_PSA=y
      - CONFIG_HUBBLE_EID_COUNTER_BASED=y
      - CONFIG_HUBBLE_EID_POOL_SIZE=32
```

## west.yml
```yaml
# Copyright (c) 2025 Hubble Network, Inc.
# SPDX-License-Identifier: Apache-2.0

manifest:
  remotes:
    - name: zephyrproject-rtos
      url-base: https://github.com/zephyrproject-rtos
    - name: buckleypaul
      url-base: https://github.com/buckleypaul

  projects:
    - name: zephyr
      remote: zephyrproject-rtos
      revision: v4.4.0
      import: true
      west-commands: scripts/west-commands.yml
    - name: riglink
      remote: buckleypaul
      revision: main
      path: modules/lib/riglink
    - name: jcon
      remote: buckleypaul
      revision: main
      path: modules/lib/jcon

  self:
    path: modules/lib/hubblenetwork-sdk
```
