## prj.conf
```kconfig
CONFIG_ZTEST=y
CONFIG_ZTEST_STACK_SIZE=4096
CONFIG_MAIN_STACK_SIZE=4096

# Hubble BLE Network
CONFIG_HUBBLE_BLE_NETWORK=y
CONFIG_HUBBLE_NETWORK_SEQUENCE_NONCE_CUSTOM=y
CONFIG_HUBBLE_UPTIME_CUSTOM=y

# Key size (match test vectors)
CONFIG_HUBBLE_NETWORK_KEY_256=y

# Disable nonce enforcement for testing arbitrary sequences
CONFIG_HUBBLE_NETWORK_SECURITY_ENFORCE_NONCE_CHECK=n
```

## src/main.c
```c
/*
 * Copyright (c) 2025 Hubble Network, Inc.
 *
 * SPDX-License-Identifier: Apache-2.0
 */

#include <hubble/hubble.h>
#include <hubble/ble.h>
#include <hubble/port/sys.h>
#include <hubble/port/crypto.h>

#include <zephyr/sys/util.h>
#include <zephyr/types.h>
#include <zephyr/ztest.h>

#include <string.h>

#include "test_vectors.h"

#define TEST_ADV_BUFFER_SZ      31
#define TIMER_COUNTER_FREQUENCY 86400000ULL

/* Test sequence counter override */
static uint16_t test_seq_override;

/* A arbitrarily chosen start time for the test */
static const uint64_t test_unix_time = (uint64_t)20 * TIMER_COUNTER_FREQUENCY;

/* Test uptime override */
static uint64_t test_uptime_ms;

uint16_t hubble_sequence_counter_get(void)
{
	return test_seq_override;
}

uint64_t hubble_uptime_get(void)
{
	return test_uptime_ms;
}

/* Test keys */
static const uint8_t test_key_primary[CONFIG_HUBBLE_KEY_SIZE] = {
	0xcd, 0x15, 0xa5, 0xab, 0xc0, 0x60, 0xb6, 0x72, 0x88, 0xa6, 0x1e,
	0x44, 0xe9, 0x95, 0xba, 0x77, 0xd1, 0x40, 0xbd, 0x46, 0x56, 0x4b,
	0x88, 0xde, 0x41, 0xc1, 0x5a, 0x92, 0x73, 0xb0, 0xce, 0x85};

/*===========================================================================*/
/* Test Suite: ble_advertise_test - Core Encryption Tests                   */
/*===========================================================================*/

#ifndef CONFIG_HUBBLE_COUNTER_SOURCE_DEVICE_UPTIME
ZTEST(ble_advertise_test, test_advertise_with_test_vectors)
{
	test_uptime_ms = 0;
	for (size_t i = 0; i < test_vectors_count; i++) {
		const struct ble_adv_test_vector *tv = &test_vectors[i];

		uint64_t unix_time =
			(uint64_t)tv->time_counter * TIMER_COUNTER_FREQUENCY;

		int ret = hubble_init(unix_time, 0, test_key_primary);
		zassert_ok(ret, "hubble_init failed");
		test_seq_override = tv->seq_no;

		uint8_t output[TEST_ADV_BUFFER_SZ];
		size_t output_len = sizeof(output);

		ret = hubble_ble_advertise_get(tv->payload, tv->payload_len,
					       output, &output_len);

		zassert_ok(ret, "Vector %zu (%s) failed with error %d", i,
			   tv->description, ret);

		zassert_equal(
			output_len,
			tv->expected_len, "Vector %zu (%s) length mismatch: got %zu, expected %zu",
			i, tv->description, output_len, tv->expected_len);

		zassert_mem_equal(output, tv->expected, output_len,
				  "Vector %zu (%s) output mismatch", i,
				  tv->description);
	}
}
#endif /* !CONFIG_HUBBLE_COUNTER_SOURCE_DEVICE_UPTIME */

ZTEST(ble_advertise_test, test_advertise_null_input_handling)
{
	int ret = hubble_init(test_unix_time, 0, test_key_primary);
	zassert_ok(ret, "hubble_init failed");
	test_seq_override = 0;

	uint8_t output[TEST_ADV_BUFFER_SZ];
	size_t output_len = sizeof(output);

	/* NULL input with zero length should succeed (empty payload is valid) */
	ret = hubble_ble_advertise_get(NULL, 0, output, &output_len);
	zassert_ok(ret, "NULL payload with length 0 should succeed");

	/* NULL output buffer should fail */
	ret = hubble_ble_advertise_get(NULL, 0, NULL, &output_len);
	zassert_equal(ret, -EINVAL, "NULL output buffer should return -EINVAL");

	/* NULL out_len should fail */
	ret = hubble_ble_advertise_get(NULL, 0, output, NULL);
	zassert_equal(ret, -EINVAL, "NULL out_len should return -EINVAL");

	/* NULL input payload with non-zero length should fail */
	output_len = sizeof(output);
	ret = hubble_ble_advertise_get(NULL, 5, output, &output_len);
	zassert_equal(
		ret, -EINVAL,
		"NULL payload with non-zero length should return -EINVAL");
}

ZTEST(ble_advertise_test, test_init_allows_deferred_key_argument)
{
	int ret;
	uint8_t output[TEST_ADV_BUFFER_SZ];
	size_t output_len = sizeof(output);

	ret = hubble_init(test_unix_time, 0, NULL);
	zassert_ok(ret, "hubble_init should allow NULL key argument");
	test_seq_override = 0;

	ret = hubble_key_set(test_key_primary);
	zassert_ok(ret, "hubble_key_set failed");

	ret = hubble_ble_advertise_get(NULL, 0, output, &output_len);
	zassert_ok(ret, "advertise should use previously configured key");
}

ZTEST(ble_advertise_test, test_advertise_buffer_too_small)
{
	uint8_t payload[] = {0x01, 0x02, 0x03, 0x04, 0x05};

	int ret = hubble_init(test_unix_time, 0, test_key_primary);
	zassert_ok(ret, "hubble_init failed");
	test_seq_override = 0;

	uint8_t output[8];
	size_t output_len = sizeof(output);

	/* Buffer too small for output */
	ret = hubble_ble_advertise_get(payload, sizeof(payload), output,
				       &output_len);
	zassert_equal(ret, -EINVAL, "Too small buffer should return -EINVAL");
}

ZTEST(ble_advertise_test, test_advertise_payload_size_limits)
{
	int ret = hubble_init(test_unix_time, 0, test_key_primary);
	zassert_ok(ret, "hubble_init failed");
	test_seq_override = 0;

	uint8_t output[TEST_ADV_BUFFER_SZ];
	size_t output_len = sizeof(output);

	/* 13-byte payload should succeed (max = HUBBLE_BLE_MAX_DATA_LEN) */
	uint8_t max_payload[HUBBLE_BLE_MAX_DATA_LEN] = {0};
	ret = hubble_ble_advertise_get(max_payload, sizeof(max_payload), output,
				       &output_len);
	zassert_ok(ret, "Max payload (13 bytes) should succeed");

	/* 14-byte payload should fail */
	uint8_t too_large_payload[HUBBLE_BLE_MAX_DATA_LEN + 1] = {0};
	output_len = sizeof(output);
	ret = hubble_ble_advertise_get(too_large_payload,
				       sizeof(too_large_payload), output,
				       &output_len);
	zassert_equal(ret, -EINVAL, "Payload > 13 bytes should return -EINVAL");
}

ZTEST(ble_advertise_test, test_advertise_deterministic)
{
	uint8_t payload[] = {0x48, 0x65, 0x6c, 0x6c, 0x6f};

	int ret = hubble_init(test_unix_time, 0, test_key_primary);
	zassert_ok(ret, "hubble_init failed");
	test_seq_override = 100;

	uint8_t output1[TEST_ADV_BUFFER_SZ];
	size_t output_len1 = sizeof(output1);

	ret = hubble_ble_advertise_get(payload, sizeof(payload), output1,
				       &output_len1);
	zassert_ok(ret);

	/* Call again with identical inputs */
	uint8_t output2[TEST_ADV_BUFFER_SZ];
	size_t output_len2 = sizeof(output2);

	ret = hubble_ble_advertise_get(payload, sizeof(payload), output2,
				       &output_len2);
	zassert_ok(ret);

	/* Verify both outputs are byte-identical */
	zassert_equal(output_len1, output_len2,
		      "Output lengths should be identical");
	zassert_mem_equal(output1, output2, output_len1,
			  "Outputs should be byte-identical (deterministic)");
}

ZTEST(ble_advertise_test, test_advertise_time_dependent_output)
{
	uint8_t payload[] = {0x48, 0x65, 0x6c, 0x6c, 0x6f};

	/* Initialize with uptime at 0 */
	test_uptime_ms = 0;
	int ret = hubble_init(test_unix_time, 0, test_key_primary);
	zassert_ok(ret, "hubble_init failed");
	test_seq_override = 100;

	uint8_t output1[TEST_ADV_BUFFER_SZ];
	size_t output_len1 = sizeof(output1);

	ret = hubble_ble_advertise_get(payload, sizeof(payload), output1,
				       &output_len1);
	zassert_ok(ret, "First call failed");

	/* Advance time by one day (TIMER_COUNTER_FREQUENCY ms)
	 * This should change the time_counter and produce different output
	 */
	test_uptime_ms = TIMER_COUNTER_FREQUENCY;

	uint8_t output2[TEST_ADV_BUFFER_SZ];
	size_t output_len2 = sizeof(output2);

	ret = hubble_ble_advertise_get(payload, sizeof(payload), output2,
				       &output_len2);
	zassert_ok(ret, "Second call failed");

	/* Outputs should have the same length but different content
	 * due to different time_counter values
	 */
	zassert_equal(output_len1, output_len2, "Output lengths should match");
	zassert_true(memcmp(output1, output2, output_len1) != 0,
		     "Outputs should differ due to time progression");
}

ZTEST(ble_advertise_test, test_advertise_same_time_different_sequences)
{
	uint8_t payload[] = {0xAA, 0xBB};

	int ret = hubble_init(test_unix_time, 0, test_key_primary);
	zassert_ok(ret, "hubble_init failed");

	/* Get output with sequence number 0 */
	test_seq_override = 0;

	uint8_t output1[TEST_ADV_BUFFER_SZ];
	size_t output_len1 = sizeof(output1);

	ret = hubble_ble_advertise_get(payload, sizeof(payload), output1,
				       &output_len1);
	zassert_ok(ret, "First call failed");

	/* Get output with sequence number 1, same time */
	test_seq_override = 1;

	uint8_t output2[TEST_ADV_BUFFER_SZ];
	size_t output_len2 = sizeof(output2);

	ret = hubble_ble_advertise_get(payload, sizeof(payload), output2,
				       &output_len2);
	zassert_ok(ret, "Second call failed");

	/* Outputs should differ due to different sequence numbers */
	zassert_equal(output_len1, output_len2, "Output lengths should match");
	zassert_true(memcmp(output1, output2, output_len1) != 0,
		     "Outputs should differ due to different sequence numbers");
}

static void *ble_advertise_test_setup(void)
{
	test_seq_override = 0;
	test_uptime_ms = 0;
	return NULL;
}

ZTEST_SUITE(ble_advertise_test, NULL, ble_advertise_test_setup, NULL, NULL, NULL);

/*===========================================================================*/
/* Test Suite: ble_advertise_format_test - Output Format Validation         */
/*===========================================================================*/

ZTEST(ble_advertise_format_test, test_service_uuid_present)
{
	uint8_t payload[] = {0xAA, 0xBB, 0xCC};

	int ret = hubble_init(test_unix_time, 0, test_key_primary);
	zassert_ok(ret, "hubble_init failed");
	test_seq_override = 0;

	uint8_t output[TEST_ADV_BUFFER_SZ];
	size_t output_len = sizeof(output);

	ret = hubble_ble_advertise_get(payload, sizeof(payload), output,
				       &output_len);
	zassert_ok(ret);

	/* Service UUID should be first 2 bytes: 0xA6 0xFC (little-endian) */
	zassert_equal(output[0], 0xA6,
		      "First byte should be 0xA6 (UUID low byte)");
	zassert_equal(output[1], 0xFC,
		      "Second byte should be 0xFC (UUID high byte)");
}

ZTEST(ble_advertise_format_test, test_output_length_calculation)
{
	int ret = hubble_init(test_unix_time, 0, test_key_primary);
	zassert_ok(ret, "hubble_init failed");

	/* Test different payload lengths */
	size_t test_payload_lens[] = {0, 1, 5, 13};

	/*
	 * Output length = 2 (UUID) + 2 (ver/seq) + 4 (tag) + 4 (EID)
	 * payload_len = 12 + payload_len
	 */
	const size_t HUBBLE_PAYLOAD_OVERHEAD = 12;

	for (size_t i = 0; i < ARRAY_SIZE(test_payload_lens); i++) {
		size_t payload_len = test_payload_lens[i];
		uint8_t payload[13] = {0};

		test_seq_override = (uint16_t)i;

		uint8_t output[TEST_ADV_BUFFER_SZ];
		size_t output_len = sizeof(output);

		ret = hubble_ble_advertise_get(payload, payload_len, output,
					       &output_len);
		zassert_ok(ret, "Failed for payload length %zu", payload_len);

		size_t expected_len = HUBBLE_PAYLOAD_OVERHEAD + payload_len;
		zassert_equal(
			output_len,
			expected_len, "Length mismatch for payload_len=%zu: got %zu, expected %zu",
			payload_len, output_len, expected_len);
	}
}

ZTEST(ble_advertise_format_test, test_sequence_number_encoding)
{
	int ret = hubble_init(test_unix_time, 0, test_key_primary);
	zassert_ok(ret, "hubble_init failed");

	/* Test various sequence numbers */
	uint16_t test_seq_nos[] = {0, 1, 255, 256, 512, 1023};

	for (size_t i = 0; i < ARRAY_SIZE(test_seq_nos); i++) {
		test_seq_override = test_seq_nos[i];

		uint8_t output[TEST_ADV_BUFFER_SZ];
		size_t output_len = sizeof(output);

		ret = hubble_ble_advertise_get(NULL, 0, output, &output_len);
		zassert_ok(ret);

		/*
		 * Parse sequence number from address field:
		 * Byte 2-3 contain protocol_version (6 bits) + seq_no (10 bits)
		 * Skip first 2 bytes (UUID), then parse bits
		 */
		uint16_t parsed_seq_no = ((output[2] & 0x03) << 8) | output[3];

		zassert_equal(parsed_seq_no, test_seq_nos[i],
			      "Seq_no mismatch: got %u, expected %u",
			      parsed_seq_no, test_seq_nos[i]);
	}
}

static void *ble_advertise_format_test_setup(void)
{
	test_seq_override = 0;
	test_uptime_ms = 0;
	return NULL;
}

ZTEST_SUITE(ble_advertise_format_test, NULL, ble_advertise_format_test_setup,
	    NULL, NULL, NULL);

/*===========================================================================*/
/* Test Suite: ble_advertise_counter_test - Counter-Based EID Tests          */
/*===========================================================================*/

#ifdef CONFIG_HUBBLE_COUNTER_SOURCE_DEVICE_UPTIME

#include "test_vectors_counter.h"

#define TEST_COUNTER_ROTATION_MS                                               \
	((uint64_t)CONFIG_HUBBLE_EID_ROTATION_PERIOD_SEC * 1000ULL)
/* Once pool size is configurable, do not hard code */
#define TEST_COUNTER_POOL_SIZE 128

ZTEST(ble_advertise_counter_test, test_counter_advertise_with_test_vectors)
{
	for (size_t i = 0; i < counter_test_vectors_count; i++) {
		const struct ble_adv_test_vector *tv = &counter_test_vectors[i];

		int ret = hubble_init(0, tv->time_counter, test_key_primary);
		zassert_ok(ret, "hubble_init failed for vector %zu", i);

		test_uptime_ms = 0;
		test_seq_override = tv->seq_no;

		uint8_t output[TEST_ADV_BUFFER_SZ];
		size_t output_len = sizeof(output);

		ret = hubble_ble_advertise_get(tv->payload, tv->payload_len,
					       output, &output_len);

		zassert_ok(ret, "Vector %zu (%s) failed with error %d", i,
			   tv->description, ret);

		zassert_equal(
			output_len,
			tv->expected_len, "Vector %zu (%s) length mismatch: got %zu, expected %zu",
			i, tv->description, output_len, tv->expected_len);

		zassert_mem_equal(output, tv->expected, output_len,
				  "Vector %zu (%s) output mismatch", i,
				  tv->description);
	}
}

ZTEST(ble_advertise_counter_test, test_counter_init_zero_valid)
{
	/* In counter mode, 0 is a valid initial counter (unlike Unix Epoch mode) */
	int ret = hubble_init(0, 0, test_key_primary);
	zassert_ok(ret, "hubble_init with counter=0 should succeed");
}

ZTEST(ble_advertise_counter_test, test_counter_wraps_at_pool_size)
{
	/* Init at pool_size - 1 (counter=127 for pool_size=128) */
	int ret = hubble_init(0, TEST_COUNTER_POOL_SIZE - 1, test_key_primary);
	zassert_ok(ret, "hubble_init failed");

	/* Advance one epoch: counter should wrap to 0 */
	test_uptime_ms = TEST_COUNTER_ROTATION_MS;
	test_seq_override = 0;

	uint8_t output_wrapped[TEST_ADV_BUFFER_SZ];
	size_t output_wrapped_len = sizeof(output_wrapped);

	ret = hubble_ble_advertise_get(NULL, 0, output_wrapped,
				       &output_wrapped_len);
	zassert_ok(ret, "advertise_get after wrap failed");

	/* Compare against counter=0 reference (TV1: counter=0, seq=0, empty) */
	ret = hubble_init(0, 0, test_key_primary);
	zassert_ok(ret, "hubble_init for reference failed");

	test_uptime_ms = 0;
	test_seq_override = 0;

	uint8_t output_ref[TEST_ADV_BUFFER_SZ];
	size_t output_ref_len = sizeof(output_ref);

	ret = hubble_ble_advertise_get(NULL, 0, output_ref, &output_ref_len);
	zassert_ok(ret, "advertise_get for reference failed");

	zassert_equal(output_wrapped_len, output_ref_len,
		      "Wrapped output length should match reference");
	zassert_mem_equal(output_wrapped, output_ref, output_wrapped_len,
			  "Wrapped counter should produce same output as "
			  "counter=0");
}

ZTEST(ble_advertise_counter_test, test_counter_advances_with_uptime)
{
	int ret = hubble_init(0, 0, test_key_primary);
	zassert_ok(ret, "hubble_init failed");
	test_seq_override = 0;

	/* Capture output at epoch 0 */
	test_uptime_ms = 0;

	uint8_t output1[TEST_ADV_BUFFER_SZ];
	size_t output_len1 = sizeof(output1);

	ret = hubble_ble_advertise_get(NULL, 0, output1, &output_len1);
	zassert_ok(ret, "First advertise_get failed");

	/* Advance one epoch */
	test_uptime_ms = TEST_COUNTER_ROTATION_MS;

	uint8_t output2[TEST_ADV_BUFFER_SZ];
	size_t output_len2 = sizeof(output2);

	ret = hubble_ble_advertise_get(NULL, 0, output2, &output_len2);
	zassert_ok(ret, "Second advertise_get failed");

	/* Different epochs should produce different output */
	zassert_true(
		memcmp(output1, output2, output_len1) != 0,
		"Different counter epochs should produce different output");
}

ZTEST(ble_advertise_counter_test, test_counter_full_wrap)
{
	/* Init at counter=0, advance by exactly pool_size epochs */
	int ret = hubble_init(0, 0, test_key_primary);
	zassert_ok(ret, "hubble_init failed");
	test_seq_override = 0;

	/* Output at epoch 0 */
	test_uptime_ms = 0;

	uint8_t output_start[TEST_ADV_BUFFER_SZ];
	size_t output_start_len = sizeof(output_start);

	ret = hubble_ble_advertise_get(NULL, 0, output_start, &output_start_len);
	zassert_ok(ret, "advertise_get at start failed");

	/* Advance by full pool size: (0 + 32) % 32 = 0 */
	test_uptime_ms =
		(uint64_t)TEST_COUNTER_POOL_SIZE * TEST_COUNTER_ROTATION_MS;

	uint8_t output_full_wrap[TEST_ADV_BUFFER_SZ];
	size_t output_full_wrap_len = sizeof(output_full_wrap);

	ret = hubble_ble_advertise_get(NULL, 0, output_full_wrap,
				       &output_full_wrap_len);
	zassert_ok(ret, "advertise_get after full wrap failed");

	/* Should match the starting output */
	zassert_equal(output_start_len, output_full_wrap_len,
		      "Full wrap output length should match start");
	zassert_mem_equal(output_start, output_full_wrap, output_start_len,
			  "Full pool wrap should produce same output as start");
}

static void *ble_advertise_counter_test_setup(void)
{
	test_seq_override = 0;
	test_uptime_ms = 0;
	return NULL;
}

ZTEST_SUITE(ble_advertise_counter_test, NULL, ble_advertise_counter_test_setup,
	    NULL, NULL, NULL);

#endif /* CONFIG_HUBBLE_COUNTER_SOURCE_DEVICE_UPTIME */
```

## src/test_vectors_counter.c
```c
/*
 * Copyright (c) 2026 Hubble Network, Inc.
 * SPDX-License-Identifier: Apache-2.0
 *
 * Counter-based EID test vectors (pool_size=128).
 *
 * Master key: cd:15:a5:ab:c0:60:b6:72:88:a6:1e:44:e9:95:ba:77:
 *             d1:40:bd:46:56:4b:88:de:41:c1:5a:92:73:b0:ce:85
 *
 * Generated with: python tools/ble-adv.py --time-counter <N> --seq-no <S>
 *                        --payload-hex <hex> --print key.bin
 */

#include "test_vectors_counter.h"

/* TV1: counter=0, seq=0, empty payload */
static const uint8_t ctv1_payload[] = {};

static const uint8_t ctv1_expected[] = {0xa6, 0xfc, 0x00, 0x00, 0xb2, 0x12,
					0x55, 0xd9, 0x94, 0x1c, 0x61, 0x36};

/* TV2: counter=0, seq=1, single byte 0xaa */
static const uint8_t ctv2_payload[] = {0xaa};

static const uint8_t ctv2_expected[] = {0xa6, 0xfc, 0x00, 0x01, 0xb2,
					0x12, 0x55, 0xd9, 0x7f, 0x23,
					0x24, 0x09, 0x7b};

/* TV3: counter=1, seq=0, "Hello" */
static const uint8_t ctv3_payload[] = {0x48, 0x65, 0x6c, 0x6c, 0x6f};

static const uint8_t ctv3_expected[] = {0xa6, 0xfc, 0x00, 0x00, 0xc9, 0xf3,
					0x09, 0xbc, 0x76, 0x5a, 0x2f, 0x55,
					0xa7, 0x97, 0x67, 0x62, 0xb7};

/* TV4: counter=5, seq=100, 0xdeadbeef */
static const uint8_t ctv4_payload[] = {0xde, 0xad, 0xbe, 0xef};

static const uint8_t ctv4_expected[] = {0xa6, 0xfc, 0x00, 0x64, 0x11, 0x31,
					0x17, 0x91, 0xb9, 0x9e, 0x2c, 0xf2,
					0xd2, 0x28, 0xdd, 0x8e};

/* TV5: counter=15, seq=0, 8 zero bytes */
static const uint8_t ctv5_payload[] = {0x00, 0x00, 0x00, 0x00,
				       0x00, 0x00, 0x00, 0x00};

static const uint8_t ctv5_expected[] = {
	0xa6, 0xfc, 0x00, 0x00, 0x17, 0x18, 0x8e, 0x9c, 0x0d, 0x42,
	0x9b, 0x21, 0x16, 0x3f, 0xdf, 0xd1, 0x6b, 0xd9, 0xef, 0x9e};

/* TV6: counter=31, seq=1023, 13 bytes (max payload) */
static const uint8_t ctv6_payload[] = {0x00, 0x01, 0x02, 0x03, 0x04, 0x05, 0x06,
				       0x07, 0x08, 0x09, 0x0a, 0x0b, 0x0c};

static const uint8_t ctv6_expected[] = {
	0xa6, 0xfc, 0x03, 0xff, 0xcd, 0xef, 0xfb, 0x5a, 0xeb,
	0x90, 0xc4, 0xf5, 0xff, 0x18, 0x87, 0x96, 0x73, 0xa6,
	0x6a, 0x52, 0xc0, 0xeb, 0x64, 0x67, 0xb6};

/* TV7: counter=31, seq=42, "Test123" */
static const uint8_t ctv7_payload[] = {0x54, 0x65, 0x73, 0x74,
				       0x31, 0x32, 0x33};

static const uint8_t ctv7_expected[] = {
	0xa6, 0xfc, 0x00, 0x2a, 0xcd, 0xef, 0xfb, 0x5a, 0x50, 0x17,
	0xfc, 0xf1, 0x2c, 0xd8, 0xb7, 0xd0, 0x64, 0x66, 0x57};

const struct ble_adv_test_vector counter_test_vectors[] = {
	{.description = "Counter=0, empty payload",
	 .time_counter = 0,
	 .seq_no = 0,
	 .payload = ctv1_payload,
	 .payload_len = 0,
	 .expected = ctv1_expected,
	 .expected_len = sizeof(ctv1_expected)},
	{.description = "Counter=0, single byte",
	 .time_counter = 0,
	 .seq_no = 1,
	 .payload = ctv2_payload,
	 .payload_len = sizeof(ctv2_payload),
	 .expected = ctv2_expected,
	 .expected_len = sizeof(ctv2_expected)},
	{.description = "Counter=1, Hello",
	 .time_counter = 1,
	 .seq_no = 0,
	 .payload = ctv3_payload,
	 .payload_len = sizeof(ctv3_payload),
	 .expected = ctv3_expected,
	 .expected_len = sizeof(ctv3_expected)},
	{.description = "Counter=5, deadbeef",
	 .time_counter = 5,
	 .seq_no = 100,
	 .payload = ctv4_payload,
	 .payload_len = sizeof(ctv4_payload),
	 .expected = ctv4_expected,
	 .expected_len = sizeof(ctv4_expected)},
	{.description = "Counter=15, 8 zeros",
	 .time_counter = 15,
	 .seq_no = 0,
	 .payload = ctv5_payload,
	 .payload_len = sizeof(ctv5_payload),
	 .expected = ctv5_expected,
	 .expected_len = sizeof(ctv5_expected)},
	{.description = "Counter=31, max payload",
	 .time_counter = 31,
	 .seq_no = 1023,
	 .payload = ctv6_payload,
	 .payload_len = sizeof(ctv6_payload),
	 .expected = ctv6_expected,
	 .expected_len = sizeof(ctv6_expected)},
	{.description = "Counter=31, Test123",
	 .time_counter = 31,
	 .seq_no = 42,
	 .payload = ctv7_payload,
	 .payload_len = sizeof(ctv7_payload),
	 .expected = ctv7_expected,
	 .expected_len = sizeof(ctv7_expected)},
};

const size_t counter_test_vectors_count =
	sizeof(counter_test_vectors) / sizeof(counter_test_vectors[0]);
```

## src/test_vectors_counter.h
```c
/*
 * Copyright (c) 2026 Hubble Network, Inc.
 * SPDX-License-Identifier: Apache-2.0
 */

#ifndef TEST_VECTORS_COUNTER_H
#define TEST_VECTORS_COUNTER_H

#include "test_vectors.h"

/* Counter-mode test vectors (pool_size=128) generated by ble-adv.py */
extern const struct ble_adv_test_vector counter_test_vectors[];
extern const size_t counter_test_vectors_count;

#endif /* TEST_VECTORS_COUNTER_H */
```
