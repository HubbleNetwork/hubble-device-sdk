## CMakeLists.txt
```
# Copyright (c) 2025 Hubble Network
#
# SPDX-License-Identifier: Apache-2.0

cmake_minimum_required(VERSION 3.20.0)
find_package(Zephyr REQUIRED HINTS $ENV{ZEPHYR_BASE})
project(riglink_ble_test)

target_sources(app PRIVATE src/main.c)
```

## prj.conf
```kconfig
# Copyright (c) 2025 Hubble Network
#
# SPDX-License-Identifier: Apache-2.0

# Hubble SDK: BLE, Unix-time counter, fully host-controlled determinism.
CONFIG_HUBBLE_BLE_NETWORK=y
CONFIG_HUBBLE_NETWORK_KEY_256=y
CONFIG_HUBBLE_COUNTER_SOURCE_UNIX_TIME=y
CONFIG_HUBBLE_NETWORK_CRYPTO_PSA=y
CONFIG_HUBBLE_UPTIME_CUSTOM=y
CONFIG_HUBBLE_NETWORK_SEQUENCE_NONCE_CUSTOM=y

# The host replays fixed sequence counters (e.g. seq 0 in several tests) to
# verify each advertisement against the reference oracle. Disable the
# nonce-reuse guard, which would otherwise reject the intentionally repeated
# counters; uniqueness is irrelevant to this deterministic test fixture.
CONFIG_HUBBLE_NETWORK_SECURITY_ENFORCE_NONCE_CHECK=n

# No radio is used; we only exercise advertisement generation.
CONFIG_BT=n

# Transport: riglink over Zephyr's shell backend. The shell owns the UART, so
# RX is interrupt-driven and won't drop bytes at 115200 (no hand-rolled ISR or
# rig_getc/rig_putc shims), and each command is dispatched as a subcommand of
# "rig" -- the host targets it with shell_root="rig".
CONFIG_RIGLINK=y
CONFIG_RIGLINK_BACKEND_SHELL=y
CONFIG_RIGLINK_MEM_ACCESS=n
CONFIG_SERIAL=y
CONFIG_REBOOT=y

# Shell (selected by RIGLINK_BACKEND_SHELL, which also pulls in JCON and the
# serial backend) configured for machine-driven I/O: no prompt, echo, or ANSI
# escapes that would corrupt the sentinel-framed JSON response stream.
CONFIG_SHELL_PROMPT_UART=""
CONFIG_SHELL_VT100_COMMANDS=n
CONFIG_SHELL_ECHO_STATUS=n
CONFIG_SHELL_HELP=n
CONFIG_SHELL_HISTORY=n
CONFIG_SHELL_METAKEYS=n
CONFIG_SHELL_TAB=n
CONFIG_SHELL_STATS=n
CONFIG_SHELL_CMD_BUFF_SIZE=256
CONFIG_SHELL_ARGC_MAX=10
# The shell's RX ring buffer defaults to 64 bytes, but the longest command line
# -- "rig test_init <64-char key hex> <epoch>" -- is ~93 bytes. A line that
# overflows the ring drops bytes mid-token, corrupting the command (a split key
# arrives as an extra argument). Size the ring to the command buffer.
CONFIG_SHELL_BACKEND_SERIAL_RX_RING_BUFFER_SIZE=256
# Commands run on the shell thread, not main(). adv_get/test_init call into PSA
# crypto (hubble_init, AES/CMAC) on top of riglink's str-arg trampoline, so give
# the shell thread the same stack the main thread had in the polled backend.
CONFIG_SHELL_STACK_SIZE=4096

# Keep the shell UART carrying only riglink's JSON: no logging to interleave
# with (and corrupt) response frames on the same wire.
CONFIG_LOG=n

CONFIG_MAIN_STACK_SIZE=4096
```

## boards/nrf52840dk_nrf52840.conf
```kconfig
# Copyright (c) 2025 Hubble Network
#
# SPDX-License-Identifier: Apache-2.0

# On the DK, riglink's shell backend takes over uart0 (the J-Link VCOM). The
# kernel console and boot banner write to that same UART via printk and would
# inject plain text into riglink's sentinel-framed JSON stream, so silence them
# and let the shell own the wire. (Logging is already disabled globally in
# prj.conf.) native_sim is unaffected: there the shell uses a dedicated
# pseudotty (uart1) while the console stays on uart0.
CONFIG_UART_CONSOLE=n
CONFIG_BOOT_BANNER=n
```

## boards/native_sim.overlay
```dts
/*
 * Copyright (c) 2025 Hubble Network
 *
 * SPDX-License-Identifier: Apache-2.0
 *
 * The harness builds native_sim/native/64, which uses
 * native_sim_native_64.overlay. This bare-name overlay exists only so a plain
 * native_sim build resolves too; include the qualified one so the riglink
 * shell-uart binding is defined in a single place.
 */

#include "native_sim_native_64.overlay"
```

## boards/native_sim_native_64.overlay
```dts
/*
 * Copyright (c) 2025 Hubble Network
 *
 * SPDX-License-Identifier: Apache-2.0
 *
 * riglink's shell backend binds to zephyr,shell-uart; put it on uart1 (its own
 * pseudotty) and leave zephyr,console on the default native uart (uart0), so
 * console output stays off the riglink wire. Matches the native_sim/native/64
 * board qualifier used by the test harness.
 */

/ {
	chosen {
		zephyr,shell-uart = &uart1;
	};
};

&uart1 {
	status = "okay";
};
```

## boards/nrf52840dk_nrf52840.overlay
```dts
/*
 * Copyright (c) 2025 Hubble Network
 *
 * SPDX-License-Identifier: Apache-2.0
 *
 * riglink's shell backend takes over uart0 (the J-Link VCOM). Bind
 * zephyr,shell-uart to it explicitly; the board .conf silences the console and
 * logging so uart0 carries only riglink's sentinel-framed JSON.
 */

/ {
	chosen {
		zephyr,shell-uart = &uart0;
	};
};

&uart0 {
	status = "okay";
	current-speed = <115200>;
};
```

## src/main.c
```c
/*
 * Copyright (c) 2025 Hubble Network
 *
 * SPDX-License-Identifier: Apache-2.0
 *
 * Host-driven test fixture: exposes the Hubble BLE advertisement API over
 * riglink, with uptime and the sequence counter overridden so the host can
 * make advertisements fully deterministic and verify them by decryption.
 *
 * Transport is riglink's Zephyr shell backend (CONFIG_RIGLINK_BACKEND_SHELL):
 * the shell owns the UART -- so RX is interrupt-driven and won't drop bytes --
 * and dispatches each command below as a subcommand of "rig" (the host targets
 * it with shell_root="rig"). This file therefore implements no rig_putc /
 * rig_getc and no rig_init() / rig_run() pump; the backend brings all of that
 * up via SYS_INIT.
 */
/* The largest str argument is the 64-char (256-bit) master key hex passed to
 * test_init; riglink's default per-arg buffer is 64 bytes, which would
 * truncate it to 63 chars (odd length -> decode failure). Size it to fit the
 * key hex plus the NUL terminator before including riglink.h.
 */
#define RIG_STR_ARG_SIZE 96
#include <riglink.h>

#include <hubble/hubble.h>

#include <zephyr/sys/util.h>

#include <string.h>

/* --- host-controlled SDK port overrides (enabled via *_CUSTOM Kconfig) --- */

static uint64_t test_uptime_ms;
static uint16_t test_seq;

uint64_t hubble_uptime_get(void)
{
	return test_uptime_ms;
}

uint16_t hubble_sequence_counter_get(void)
{
	return test_seq;
}

/* --- helpers --- */

/* hubble_init/hubble_key_set store the key pointer without copying, so the
 * buffer must outlive every advertisement call: keep it static.
 */
static uint8_t master_key[CONFIG_HUBBLE_KEY_SIZE];

/* --- exposed surface --- */

RIG_FN(int, test_init, str, uint64_t)
{
	if (hex2bin(arg0, strlen(arg0), master_key, sizeof(master_key)) !=
	    sizeof(master_key)) {
		return -1;
	}
	test_uptime_ms = 0U;
	test_seq = 0U;
	return hubble_init(arg1, master_key);
}

RIG_FN(void, test_set_uptime, uint64_t)
{
	test_uptime_ms = arg0;
}

RIG_FN(void, test_set_seq, uint16_t)
{
	test_seq = arg0;
}

RIG_FN(int, adv_get, str)
{
	uint8_t input[HUBBLE_BLE_MAX_DATA_LEN + 1];
	uint8_t out[HUBBLE_BLE_ADV_HEADER_SIZE + HUBBLE_BLE_MAX_DATA_LEN + 1];
	char hexout[2U * sizeof(out) + 1U];
	size_t out_len = sizeof(out);
	size_t hlen = strlen(arg0);
	size_t in_len = hex2bin(arg0, hlen, input, sizeof(input));

	/* hex2bin returns 0 for both an empty payload (valid) and a decode
	 * failure; only a non-empty input that decoded to nothing is an error.
	 */
	if (in_len == 0U && hlen != 0U) {
		return -1;
	}

	int status = hubble_ble_advertise_get(input, in_len, out, &out_len);

	if (status != 0) {
		return status;
	}

	bin2hex(out, out_len, hexout, sizeof(hexout));

	rig_emit("adv_hex", hexout);
	rig_emit("adv_len", (int64_t)out_len);
	return 0;
}

RIG_EXPOSE(uint32_t, hubble_ble_advertise_expiration_get);

int main(void)
{
	/* The riglink shell backend runs the link from SYS_INIT and the shell
	 * thread; the main thread has nothing to do.
	 */
	return 0;
}
```
